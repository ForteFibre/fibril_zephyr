## drivers/encoder/Kconfig.as5047p
```kconfig
config ENCODER_AS5047P
	bool "ams AS5047P magnetic angle sensor driver"
	default y
	depends on DT_HAS_AMS_AS5047P_ENABLED
	select SPI
	help
	  Enable support for the ams AS5047P 14-bit magnetic angle sensor on
	  SPI. A thread per device polls the angle so that the accumulated
	  position stays continuous across the turn.

if ENCODER_AS5047P

config ENCODER_AS5047P_THREAD_STACK_SIZE
	int "AS5047P poll thread stack size"
	default 768
	help
	  Stack size of the thread that polls one AS5047P.

config ENCODER_AS5047P_THREAD_PRIORITY
	int "AS5047P poll thread priority"
	default 5
	help
	  Priority of the thread that polls one AS5047P. The interval it
	  measures between two readings feeds the velocity, so a priority that
	  lets other work delay it makes the velocity noisier, not wrong.

endif # ENCODER_AS5047P
```

## drivers/encoder/Kconfig.vesc
```kconfig
config ENCODER_VESC
	bool "VESC position encoder shim"
	default y
	depends on MOTOR_VESC
	depends on DT_HAS_VESC_ENCODER_ENABLED
	help
	  Expose VESC STATUS_4 position as a continuous encoder-class device.
```

## drivers/motor/Kconfig.vesc
```kconfig
config MOTOR_VESC
	bool "VESC CAN motor driver"
	default y
	depends on CAN
	depends on DT_HAS_VESC_BUS_ENABLED
	help
	  Eight runtime-bindable VESC motor slots on one classic CAN bus.

if MOTOR_VESC

config MOTOR_VESC_WORK_PERIOD_US
	int "VESC driver service period in microseconds"
	default 1000
	range 500 10000

config MOTOR_VESC_DIAGNOSTICS
	bool "VESC serial diagnostics"
	depends on LOG
	help
	  Emit rate-limited raw RX/TX frames, decoded values, configuration,
	  state changes, and periodic counters through the Zephyr console. CAN RX
	  callbacks only enqueue bounded records; formatting runs in system work
	  queue context. Leave this disabled in normal firmware.

config MOTOR_VESC_DIAGNOSTICS_FIRST_FRAMES
	int "Initial frames logged per packet and CAN ID"
	default 3
	range 1 10
	depends on MOTOR_VESC_DIAGNOSTICS

config MOTOR_VESC_DIAGNOSTICS_STATUS_PERIOD_MS
	int "Periodic STATUS frames logged per CAN ID"
	default 0
	range 0 10000
	depends on MOTOR_VESC_DIAGNOSTICS
	help
	  Log one received VESC STATUS frame at this interval for each CAN ID,
	  in addition to the initial sample. Zero disables periodic STATUS logs.

config MOTOR_VESC_DIAGNOSTICS_SUMMARY_MS
	int "Diagnostic summary interval in milliseconds"
	default 1000
	range 100 60000
	depends on MOTOR_VESC_DIAGNOSTICS

config MOTOR_VESC_DIAGNOSTICS_WORKQ_STACK_SIZE
	int "Diagnostic work queue stack size"
	default 2048
	depends on MOTOR_VESC_DIAGNOSTICS

config MOTOR_VESC_DIAGNOSTICS_WORKQ_PRIORITY
	int "Diagnostic work queue priority"
	default 14
	range 0 14
	depends on MOTOR_VESC_DIAGNOSTICS
	help
	  Keep this numerically larger (lower priority) than control and CAN work.

endif
```

## dts/bindings/encoder/ams,as5047p.yaml
```yaml
description: |
  ams AS5047P 14-bit on-axis magnetic angle sensor, read over SPI.

  The angle is absolute within one turn. The driver accumulates it into a
  continuous position, so the node is used through the generic encoder class.

    &spi1 {
        cs-gpios = <&gpioa 4 GPIO_ACTIVE_LOW>;

        angle0: as5047p@0 {
            compatible = "ams,as5047p";
            reg = <0>;
            spi-max-frequency = <8000000>;
        };
    };

  The device accepts up to 10 MHz on SCLK.

compatible: "ams,as5047p"

include: [spi-device.yaml]

properties:
  poll-interval-us:
    type: int
    default: 1000
    description: |
      Interval between two reads of the angle, in microseconds.

      The driver reads on its own rather than when a reading is requested,
      because the angle has to be observed at least twice per turn for the
      accumulated position to stay continuous. The interval therefore bounds
      the speed that can be resolved: less than half a turn per interval,
      which is 30000 rpm at the default.

      An interval shorter than one kernel tick is rounded up to a tick.

  offline-threshold:
    type: int
    default: 3
    description: |
      Number of consecutive failed reads after which the encoder is reported
      offline and its accumulated position is rebuilt on the next good
      reading. Below this the last good reading is kept and reported as
      stale, so a single corrupted frame does not disturb a control loop.

  invert-direction:
    type: boolean
    description: |
      Report motion with the opposite sign.

      This flips the accumulated position and velocity in software. The
      single-turn angle is still what the device reported. The driver does
      not touch the device's DIR setting, so the direction is flipped the
      same way as on the other encoder drivers.
```

## dts/bindings/encoder/vesc,encoder.yaml
```yaml
# Copyright (c) 2026
# SPDX-License-Identifier: Apache-2.0

description: |
  VESC STATUS_4 single-turn position exposed as a continuous encoder. The
  position is retained while offline and the first frame after reconnect is
  unwrapped against the last received angle.
compatible: "vesc,encoder"
include: base.yaml
properties:
  motor:
    type: phandle
    required: true
    description: vesc,motor logical slot whose STATUS_4 position is observed.
```

## dts/bindings/fibril_can_node/fibril,fcan-vesc.yaml
```yaml
# Copyright (c) 2026
# SPDX-License-Identifier: Apache-2.0

description: |
  Runtime VESC assignment and diagnostics. motors must contain the fixed eight
  vesc,motor logical slots in slot order. VescMotor instances are named by
  fcan-ns; one VescBus instance is named vesc_bus. A VescMotor may share the
  same motorN namespace as the MdMotor that controls it because their schema
  members are disjoint.
compatible: "fibril,fcan-vesc"
include: base.yaml
properties:
  fcan-ns:
    type: string
    required: true
  motors:
    type: phandles
    required: true
    description: Exactly eight vesc,motor logical slots in slot order.
```

## dts/bindings/motor/dji,robomaster-motor.yaml
```yaml
description: DJI RoboMaster C610/C620 motor node

compatible: "dji,robomaster-motor"

include: base.yaml

on-bus: dji,robomaster

properties:
  reg:
    required: true
    description: Motor ID on the RoboMaster bus, in the range 1..8.
  model:
    type: string
    required: true
    enum:
      - c610
      - c620
    description: |
      Motor controller model. The driver converts between A and the
      controller's current codes with it: a C620 takes and reports +-16384 for
      +-20 A, a C610 +-10000 for +-10 A. A C610 reports no temperature.
  max-current-ma:
    type: int
    description: |
      Largest current, in mA, the driver commands either way; it must be
      positive. Absent, the
      model's full range applies (20000 for a C620, 10000 for a C610), and a
      larger value is capped there too.
  gear-ratio:
    type: int
    description: Optional motor gear ratio metadata for higher-level control.
```

## dts/bindings/motor/vesc,bus.yaml
```yaml
# Copyright (c) 2026
# SPDX-License-Identifier: Apache-2.0

description: |
  One classic-CAN VESC bus with exactly eight logical motor slots. Physical
  VESC CAN IDs are assigned at runtime; child reg values are logical slots.

compatible: "vesc,bus"
include: base.yaml
bus: vesc

properties:
  "#address-cells": { required: true, const: 1 }
  "#size-cells": { required: true, const: 0 }
  cans:
    type: phandle
    required: true
    description: Dedicated CAN controller used by this bus.
  absolute-max-current-ma:
    type: int
    required: true
    description: Absolute driver-side current clamp in mA for every slot.
  max-feedback-timeout-ms:
    type: int
    required: true
    description: Largest runtime feedback timeout accepted, in ms.
  min-command-period-us:
    type: int
    required: true
    description: Smallest runtime command resend period accepted, in us.
  max-reconnect-frames:
    type: int
    default: 10
    description: Largest consecutive STATUS count accepted for reconnection.
  controller-id:
    type: int
    required: true
    const: 254
    description: >
      This node's source ID in selective-values requests and the destination
      ID in replies. ID 254 is reserved for the MiniV4 controller; 255 is the
      VESC broadcast ID. Neither ID may be assigned to a motor slot.

child-binding:
  description: A logical slot. reg is 0 through 7, not a VESC CAN ID.
  compatible: "vesc,motor"
  include: base.yaml
  properties:
    reg: { required: true }
```

## lib/fibril_can_node/vesc/Kconfig
```kconfig
config FIBRIL_CAN_NODE_VESC
	bool "VESC runtime configuration and diagnostics"
	default y
	depends on MOTOR_VESC
	depends on DT_HAS_FIBRIL_FCAN_VESC_ENABLED

config FIBRIL_CAN_NODE_VESC_MAX
	int
	default 8
	range 8 8
	depends on FIBRIL_CAN_NODE_VESC

config FIBRIL_CAN_NODE_VESC_HARDWARE_SELFTEST
	bool "Inject a zero-output VESC hardware self-test"
	depends on FIBRIL_CAN_NODE_VESC
	depends on FIBRIL_CAN_NODE_MD_MOTOR
	depends on MOTOR_VESC_DIAGNOSTICS
	help
	  Hardware bring-up only. Bind slot 0 to VESC CAN ID 0 with conservative
	  timing, then inject one DUTY target whose value is exactly zero after
	  feedback makes the motor healthy. This exercises the normal MdMotor,
	  motor class, and VESC driver path without a fibril_can master.

	  The test never injects a non-zero target. Leave it disabled in normal
	  firmware and in receive-only diagnostic builds.
```

## tests/drivers/encoder/as5047p/testcase.yaml
```yaml
tests:
  drivers.encoder.as5047p:
    tags:
      - drivers
      - encoder
      - spi
    platform_allow:
      - native_sim
      - native_sim/native/64
    integration_platforms:
      - native_sim
      - native_sim/native/64
```
