## boards/fibril/canmotor_tourobo2023/Kconfig.fibril_canmotor_tourobo2023
```kconfig
# SPDX-License-Identifier: Apache-2.0

config BOARD_FIBRIL_CANMOTOR_TOUROBO2023
	select SOC_STM32F407XG
```

## boards/fibril/canmotor_tourobo2023/board.yml
```yaml
board:
  name: fibril_canmotor_tourobo2023
  full_name: Fibril CanMotor Tourobo 2023
  vendor: fibril
  socs:
    - name: stm32f407xx
```

## boards/fibril/canmotor_tourobo2023/fibril_canmotor_tourobo2023_defconfig
```kconfig
# SPDX-License-Identifier: Apache-2.0

CONFIG_SERIAL=y
CONFIG_GPIO=y

CONFIG_CONSOLE=y
CONFIG_UART_CONSOLE=y

CONFIG_ARM_MPU=y
CONFIG_HW_STACK_PROTECTION=y
CONFIG_CAN_MCP251XFD_INT_THREAD_STACK_SIZE=2048
```

## boards/fibril/rc26_mainair_v01/Kconfig.fibril_rc26_mainair_v01
```kconfig
# SPDX-License-Identifier: Apache-2.0

config BOARD_FIBRIL_RC26_MAINAIR_V01
	select SOC_STM32G474XX
```

## boards/fibril/rc26_mainair_v01/board.yml
```yaml
board:
  name: fibril_rc26_mainair_v01
  full_name: Fibril RC26 MainAir V01
  vendor: fibril
  socs:
    - name: stm32g474xx
```

## boards/fibril/robomaster_miniv1/Kconfig.robomaster_miniv1
```kconfig
# Copyright (c) 2026
# SPDX-License-Identifier: Apache-2.0

config BOARD_ROBOMASTER_MINIV1
	select SOC_STM32G474XX
```

## boards/fibril/robomaster_miniv1/board.yml
```yaml
board:
  name: fibril_robomaster_miniv1
  full_name: Fibril RoboMaster Mini V1
  vendor: fibril
  socs:
    - name: stm32g474xx
```

## boards/fibril/robomaster_miniv3/Kconfig.fibril_robomaster_miniv3
```kconfig
# SPDX-License-Identifier: Apache-2.0

config BOARD_FIBRIL_ROBOMASTER_MINIV3
	select SOC_STM32G474XX
```

## boards/fibril/robomaster_miniv3/board.yml
```yaml
board:
  name: fibril_robomaster_miniv3
  full_name: Fibril RoboMaster Mini V3
  vendor: fibril
  socs:
    - name: stm32g474xx
```

## boards/fibril/robomaster_miniv4/Kconfig.fibril_robomaster_miniv4
```kconfig
# SPDX-License-Identifier: Apache-2.0

config BOARD_FIBRIL_ROBOMASTER_MINIV4
	select SOC_STM32G474XX
```

## boards/fibril/robomaster_miniv4/board.yml
```yaml
board:
  name: fibril_robomaster_miniv4
  full_name: Fibril RoboMaster Mini V4
  vendor: fibril
  socs:
    - name: stm32g474xx
```

## boards/fibril/robomaster_v2/board.yml
```yaml
# Copyright (c) 2024 Nordic Semiconductor ASA
# SPDX-License-Identifier: Apache-2.0

board:
  name: fibril_robomaster_v2
  full_name: Fibril RoboMaster Bridge V2
  vendor: fibril
  socs:
    - name: stm32g474xx
```

## drivers/encoder/Kconfig
```kconfig
menuconfig ENCODER
	bool "Encoder driver support"
	help
	  Enable rotary encoder driver support

if ENCODER

config ENCODER_INIT_PRIORITY
	int "Encoder driver init priority"
	default 85
	help
	  Encoder driver initialization priority.

module = ENCODER
module-str = encoder
source "subsys/logging/Kconfig.template.log_config"

endif # ENCODER
```

## drivers/encoder/Kconfig.amt21
```kconfig
config ENCODER_AMT21
	bool "Same Sky (CUI Devices) AMT21x absolute encoder driver"
	default y
	depends on SERIAL
	depends on UART_ASYNC_API
	depends on DT_HAS_CUI_AMT21_ENABLED
	help
	  Enable support for AMT21x series absolute encoders on a half-duplex
	  RS485 bus. One AMT21 bus device owns the UART and polls every encoder
	  child node in turn, so each encoder is exposed as its own logical
	  device.

if ENCODER_AMT21

config ENCODER_AMT21_MAX_ENCODERS
	int "Maximum encoders per AMT21 bus"
	default 8
	range 1 64
	help
	  Number of encoder child nodes a single AMT21 bus can serve. The RS485
	  addressing scheme allows up to 64, but each slot costs a pointer, so
	  the default is sized for typical use.

config ENCODER_AMT21_THREAD_STACK_SIZE
	int "AMT21 poll thread stack size"
	default 1024
	help
	  Stack size of the thread that sequences transactions on an AMT21 bus.

config ENCODER_AMT21_THREAD_PRIORITY
	int "AMT21 poll thread priority"
	default 5
	help
	  Priority of the thread that sequences transactions on an AMT21 bus.
	  The transport keeps the UART receiver permanently enabled, so being
	  preempted mid-transaction does not lose data. A cooperative priority
	  is still preferable when the bus is polled at a high rate.

config ENCODER_AMT21_STATS
	bool "AMT21 detailed error statistics"
	help
	  Track a per-cause breakdown of failed transactions, exposed through
	  amt21_get_stats() and amt21_bus_get_stats(). This costs roughly 60
	  bytes per encoder plus 24 bytes per bus. When disabled, the counters
	  are compiled out entirely and only the aggregate error count in
	  struct encoder_feedback remains available.

if ENCODER_AMT21_STATS

config ENCODER_AMT21_ERROR_LOG_SIZE
	int "AMT21 error log depth"
	default 0
	range 0 64
	help
	  Number of recent failed transactions to record per encoder, including
	  the raw bytes that were received. Reading the log back with
	  amt21_get_error_log() is the most direct way to tell a framing
	  desync apart from a checksum failure or a stray echo byte. Each entry
	  costs 16 bytes. Set to 0 to disable the log.

endif # ENCODER_AMT21_STATS

config ENCODER_AMT21_SHELL
	bool "AMT21 shell commands"
	depends on SHELL
	help
	  Add an "amt21" command for inspecting encoders on a running target:
	  the latest snapshot, the statistics, and the recorded failures with
	  the raw bytes that were received. This is the quickest way to tell
	  why responses are being dropped on real hardware.

endif # ENCODER_AMT21
```

## drivers/encoder/Kconfig.qdec_stm32
```kconfig
config ENCODER_QDEC_STM32
	bool "STM32 timer quadrature encoder driver"
	default y
	depends on DT_HAS_FIBRIL_STM32_QDEC_ENABLED
	select PINCTRL
	help
	  Enable support for a quadrature encoder decoded by an STM32 general
	  purpose timer. The timer counts edges in hardware; the driver samples
	  the counter periodically so that the accumulated position stays
	  continuous across the counter's wrap.

	  This is not the upstream st,stm32-qdec driver. That one sets the
	  timer's auto-reload to a multiple of the counts per revolution and
	  does not publish the value, which leaves a consumer unable to tell
	  where the counter wraps.
```

## drivers/encoder/Kconfig.robomaster
```kconfig
config ENCODER_ROBOMASTER
	bool "DJI RoboMaster rotor encoder"
	default y
	depends on MOTOR_DJI_ROBOMASTER
	depends on DT_HAS_DJI_ROBOMASTER_ENCODER_ENABLED
	help
	  Expose the rotor angle a RoboMaster ESC reports as an encoder class
	  device, so that a control loop can close around the motor's own
	  rotor instead of an encoder fitted to the shaft. The device follows
	  every feedback frame of the motor it names, through the RoboMaster
	  driver's rotor callback.
```

## drivers/imu/Kconfig
```kconfig
menuconfig IMU
	bool "IMU driver support"
	help
	  Enable inertial measurement unit and attitude sensor driver support

if IMU

config IMU_INIT_PRIORITY
	int "IMU driver init priority"
	default 85
	help
	  IMU driver initialization priority.

module = IMU
module-str = imu
source "subsys/logging/Kconfig.template.log_config"

# zephyr-keep-sorted-start
rsource "Kconfig.r6093u"

# zephyr-keep-sorted-stop

endif # IMU
```

## drivers/imu/Kconfig.r6093u
```kconfig
config IMU_R6093U
	bool "CruizCore R6093U gyro driver"
	default y
	depends on SERIAL
	depends on SERIAL_SUPPORT_INTERRUPT
	depends on DT_HAS_CRUIZCORE_R6093U_ENABLED
	select UART_INTERRUPT_DRIVEN
	help
	  Enable support for the CruizCore R6093U, which streams its attitude,
	  angular velocity and acceleration over a UART. The driver follows the
	  wrap of the yaw so that it reads continuously, and re-arms the
	  receiver when the stream stops.
```

## drivers/motor/Kconfig
```kconfig
menuconfig MOTOR
	bool "Motor driver support"
	help
	  Enable motor driver support

if MOTOR

config MOTOR_INIT_PRIORITY
	int "Motor driver init priority"
	default 85
	help
	  Motor driver initialization priority.
module = MOTOR
module-str = motor
source "subsys/logging/Kconfig.template.log_config"

# zephyr-keep-sorted-start
rsource "Kconfig.robomaster"

# zephyr-keep-sorted-stop

endif # MOTOR
```

## drivers/motor/Kconfig.dji
```kconfig
config MOTOR_DJI_ROBOMASTER
	bool "DJI RoboMaster motor driver"
	default y
	depends on DT_HAS_DJI_ROBOMASTER_ENABLED && CAN
	select NET_BUF
	select POLL
```

## drivers/motor/Kconfig.odrive
```kconfig
config MOTOR_ODRIVE
	bool "ODrive motor controller driver"
	default y
	depends on CAN
	depends on DT_HAS_ODRIVE_BUS_ENABLED
	help
	  Enable support for ODrive Pro, S1 and Micro on a classic CAN bus with
	  11-bit identifiers, speaking CANSimple. Targets are set through
	  include/drivers/motor/odrive.h; the generic motor class carries
	  enable, disable and the feedback snapshot.

if MOTOR_ODRIVE

config MOTOR_ODRIVE_MAX_AXES
	int "Maximum axes per ODrive bus"
	default 4
	range 1 16
	help
	  Size of the registration table of one bus node. Each entry is a
	  pointer. The driver adds one hardware receive filter per axis, so this
	  is also bounded by what the controller offers.

config MOTOR_ODRIVE_TX_INTERVAL_MS
	int "Command interval in milliseconds"
	default 10
	range 1 100
	help
	  How often each armed axis is commanded. This feeds the ODrive's
	  watchdog and bounds how stale a setpoint can be. Feedback does not
	  depend on it: the ODrive broadcasts on its own schedule.

config MOTOR_ODRIVE_STATE_RETRY_MS
	int "Axis state retry interval in milliseconds"
	default 200
	range 10 5000
	help
	  How long to wait for the heartbeat to confirm closed loop control
	  before requesting it again. The retry never clears errors, so an axis
	  that trips is not cycled through a fault automatically.

config MOTOR_ODRIVE_WORKQ_STACK_SIZE
	int "Callback work queue stack size"
	default 1024
	help
	  Stack of the per-bus thread that runs the application callbacks
	  registered through odrive.h. It must fit whatever those callbacks do.

config MOTOR_ODRIVE_WORKQ_PRIORITY
	int "Callback work queue thread priority"
	default 5
	help
	  Priority of the per-bus callback thread. Commands are sent from the
	  system work queue, so a callback that runs long does not delay them.
	  It does delay later callbacks, including the state change that
	  reports a disarm, so it must not block.

endif # MOTOR_ODRIVE
```

## drivers/motor/Kconfig.robomaster
```kconfig
config MOTOR_DJI_ROBOMASTER
	bool "DJI RoboMaster C610/C620 motor driver"
	default y
	depends on CAN
	depends on DT_HAS_DJI_ROBOMASTER_ENABLED
	help
	  Enable support for DJI RoboMaster C610/C620 motor controllers exposed
	  as one logical motor device per motor.
```

## drivers/motor/Kconfig.robstride
```kconfig
config MOTOR_ROBSTRIDE
	bool "RobStride actuator driver"
	default y
	depends on CAN
	depends on DT_HAS_ROBSTRIDE_BUS_ENABLED
	help
	  Enable support for RobStride actuators on a classic CAN bus with
	  29-bit identifiers. Targets are set through
	  include/drivers/motor/robstride.h; the generic motor class carries
	  enable, disable and the feedback snapshot.

if MOTOR_ROBSTRIDE

config MOTOR_ROBSTRIDE_MAX_MOTORS
	int "Maximum motors per RobStride bus"
	default 8
	range 1 32
	help
	  Size of the registration table of one bus node. Each entry is a
	  pointer.

config MOTOR_ROBSTRIDE_TX_INTERVAL_MS
	int "Command interval in milliseconds"
	default 5
	range 1 100
	help
	  How often each enabled motor is commanded. Feedback arrives as the
	  reply to a command, so this also sets the feedback rate. Every motor
	  needs its own frame, so the bus load grows with the motor count.

config MOTOR_ROBSTRIDE_PARAM_TIMEOUT_MS
	int "Parameter read timeout in milliseconds"
	default 50
	range 1 1000
	help
	  How long robstride_get_parameter() waits for the motor to answer.

config MOTOR_ROBSTRIDE_VERIFY
	bool "Read back every parameter the handshake writes"
	default y
	help
	  Count a parameter as written only once the motor has answered a read
	  of it with the value sent. A frame reaching the wire proves nothing:
	  any node on the bus acknowledges it. Turning this off makes the
	  handshake trust the transmit completion alone, which is shorter by
	  one interval per batch of writes.

config MOTOR_ROBSTRIDE_VERIFY_TIMEOUT_MS
	int "Readback timeout in milliseconds"
	default 20
	range 1 1000
	depends on MOTOR_ROBSTRIDE_VERIFY
	help
	  How long the handshake waits for the replies to one batch of reads
	  before writing that batch again.

config MOTOR_ROBSTRIDE_VERIFY_RETRIES
	int "Writes of one batch before configuring starts over"
	default 3
	range 1 100
	depends on MOTOR_ROBSTRIDE_VERIFY
	help
	  A batch the motor still has not confirmed after this many writes
	  counts as a failed configuration: the driver waits
	  MOTOR_ROBSTRIDE_CONFIGURE_BACKOFF_MS and starts again from the stop
	  frame.

config MOTOR_ROBSTRIDE_RUNNING_TIMEOUT_MS
	int "Time for the motor to report running after enable"
	default 100
	range 1 10000
	help
	  No command is sent until a feedback frame reports the motor running
	  after the enable. A motor that has not by then, and is not
	  calibrating, counts as a failed configuration.

config MOTOR_ROBSTRIDE_CONFIGURE_BACKOFF_MS
	int "Pause before configuring again after a failure"
	default 200
	range 0 10000
	help
	  How long the driver leaves a motor alone after giving up on
	  configuring it, before starting again from the stop frame.

endif # MOTOR_ROBSTRIDE
```

## drivers/sensor/Kconfig
```kconfig
# Copyright (c) 2021 Nordic Semiconductor ASA
# SPDX-License-Identifier: Apache-2.0

if SENSOR
rsource "example_sensor/Kconfig"
rsource "as5047p/Kconfig"
endif # SENSOR
```

## drivers/sensor/as5047p/Kconfig
```kconfig
# Copyright (c) 2026 Forte Fibre
# SPDX-License-Identifier: Apache-2.0

config AS5047P
	bool "AS5047P angular position sensor"
	default y
	depends on DT_HAS_AMS_AS5047P_ENABLED
	select SPI
	help
	  Enable driver for the ams AS5047P SPI angular position sensor.
```
