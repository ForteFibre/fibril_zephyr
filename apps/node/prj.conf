## CMakeLists.txt
```
# Copyright (c) 2026
# SPDX-License-Identifier: Apache-2.0
#
# The fibril_can slave application. One image serves every board that is a
# slave on the bus: the devicetree says which functions it carries and what
# hardware they drive, and a hand-written header names the node.

cmake_minimum_required(VERSION 3.20.0)
find_package(Zephyr REQUIRED HINTS $ENV{ZEPHYR_BASE})

# C stays alongside C++: the generated schema_blob.c and lib/fcan_transport/
# are C whichever wrapper the application uses.
project(fibril_node LANGUAGES C CXX)

if(NOT ZEPHYR_FIBRIL_CAN_MODULE_DIR)
  message(FATAL_ERROR
    "ZEPHYR_FIBRIL_CAN_MODULE_DIR is not set — is the fibril_can module on "
    "the west manifest and is CONFIG_FIBRIL_CAN=y?")
endif()

if(NOT CONFIG_FIBRIL_NODE_SCHEMA)
  message(FATAL_ERROR
    "CONFIG_FIBRIL_NODE_SCHEMA is empty. A build needs a transport snippet and "
    "a deployment snippet, e.g. "
    "`west build -b <board> apps/node -S rc26-mainair-usb -S rc26-air`.")
endif()

include(${ZEPHYR_FIBRIL_CAN_MODULE_DIR}/zephyr/cmake/fcan_invoke_codegen.cmake)

# Kconfig, not a CMake argument: the node header belongs to the same
# per-robot choice as the overlay and the node id, and a snippet can only
# append Kconfig and devicetree fragments.
set(NODE_SCHEMA "${ZEPHYR_FIBRIL_ZEPHYR_MODULE_DIR}/${CONFIG_FIBRIL_NODE_SCHEMA}")

if(NOT EXISTS "${NODE_SCHEMA}")
  message(FATAL_ERROR "CONFIG_FIBRIL_NODE_SCHEMA points at a missing file: ${NODE_SCHEMA}")
endif()

# The schema is assembled from three kinds of fragment, which the codegen
# merges deterministically:
#
#   NODE_SCHEMA           the node's identity and limits, written by hand
#   FCAN_TYPE_SCHEMAS     every block type this repository implements
#   FCAN_INSTANCE_SCHEMAS the instances each enabled function derived from
#                         its devicetree node
#   FCAN_BUILTIN_SCHEMAS  instances the image carries without a devicetree
#                         node (can_diag, derived from the transport)
#
# Types are offered wholesale rather than curated: an unreferenced one is
# dropped before the blob is built, so the list costs nothing. What the image
# drives is decided by the devicetree alone; the built-in instances only
# report on the transport the devicetree chose.
get_property(FCAN_TYPE_SCHEMAS GLOBAL PROPERTY fibril_can_node_type_schemas)
get_property(FCAN_INSTANCE_SCHEMAS GLOBAL PROPERTY fibril_can_node_instance_schemas)
get_property(FCAN_BUILTIN_SCHEMAS GLOBAL PROPERTY fibril_can_node_builtin_instance_schemas)

# Checked on the devicetree's instances alone: the built-in ones are in every
# image, so counting them would let an image that drives nothing through.
if(NOT FCAN_INSTANCE_SCHEMAS)
  message(FATAL_ERROR
    "No function is enabled: the devicetree describes no fibril,fcan-* node, "
    "so this image would announce nothing. Add a deployment snippet.")
endif()

fcan_invoke_codegen(
  SCHEMA     "${NODE_SCHEMA}" ${FCAN_TYPE_SCHEMAS} ${FCAN_INSTANCE_SCHEMAS} ${FCAN_BUILTIN_SCHEMAS}
  OUTPUT_DIR "${CMAKE_CURRENT_BINARY_DIR}/schema_gen"
  BASE_NAME  schema_gen
  LANGUAGE   CXX)

# Backing section for FIBRIL_FCAN_FUNC_DEFINE (include/fibril_can_node/func.h).
# Both calls are needed and neither covers the other: the .ld fragment feeds
# the linker template that ARM builds actually use, and zephyr_iterable_section
# feeds the CMake linker generator. Declaring only the second one links with
# the list symbols undefined.
zephyr_linker_sources(DATA_SECTIONS sections-ram.ld)
zephyr_iterable_section(NAME fibril_fcan_func GROUP DATA_REGION ${XIP_ALIGN_WITH_INPUT})

target_sources(app PRIVATE src/main.cpp)
```

## Kconfig
```
# Copyright (c) 2026
# SPDX-License-Identifier: Apache-2.0

menu "fibril_can node"

config APP_WATCHDOG
	bool "Reset the board when the function ticks stop"
	default y
	depends on WATCHDOG
	depends on $(dt_alias_enabled,watchdog0)
	help
	  Start the watchdog0 device just before handing over to the transport
	  and feed it from the function ticks. A tick that stops running then
	  resets the board instead of leaving the last output on the motors.

	  Whether a stalled fcan_poll is caught depends on the transport. The
	  direct transport runs the ticks and fcan_poll on one thread, so
	  either stopping starves the watchdog. Behind a hub, fcan_poll runs on
	  the hub driver's thread and the ticks keep feeding the watchdog
	  without it.

	  An image with no tick has nothing to feed it from, so the watchdog
	  stays off there and says so in the log.

config APP_WATCHDOG_TIMEOUT_MS
	int "Watchdog timeout in milliseconds"
	default 1000
	depends on APP_WATCHDOG
	help
	  1000 is what CanMotorMbed gave the IWDG. The ticks run every
	  millisecond, so this only has to cover how long a tick may
	  legitimately be held up.

config APP_FCAN_HEAP_SIZE
	int "Bytes reserved for the fibril_can node"
	default 16384
	help
	  The node and the arena fcan_init carves its buffers from are both
	  allocated from this heap, once, at boot. The arena grows with the
	  schema's limits and with how many instances the board wires, so the
	  default leaves room for any deployment rather than fitting one.

	  Lower it in a deployment snippet when the board is short of RAM.
	  Enable SYS_HEAP_RUNTIME_STATS to have the node log how much of it
	  the boot actually used. Below that, fibril_fcan_node_init() fails
	  and main returns before attaching the transport, so the node never
	  reaches the bus. The node is allocated first: if even it does not
	  fit, the log says "out of memory for the node" and the call returns
	  -ENOMEM. Otherwise fcan_init cannot get its arena, the log says
	  "fcan_init failed" with the NOMEM fault, and the call returns -EIO.

endmenu

menu "Zephyr"
source "Kconfig.zephyr"
endmenu

module = APP
module-str = APP
source "subsys/logging/Kconfig.template.log_config"
```

## sample.yaml
```
# SPDX-License-Identifier: Apache-2.0
#
# One scenario per image that gets flashed. Two snippets name a node: the
# board's transport snippet says how it reaches the bus, the deployment
# snippet says who it is and what it drives.

sample:
  name: fibril_can node
  description: >-
    fibril_can slave. Which block types it carries comes from the
    fibril,fcan-* nodes in its devicetree; the application itself names none
    of them.

common:
  build_only: true
  # Codegen needs the fcan_codegen CLI. It is found automatically where the
  # ros-jazzy-fibril-can-codegen package is installed, and otherwise built
  # from modules/lib/fibril_can (needs protobuf and yaml-cpp). To pick one,
  # set it in the environment, which is what reaches the helper:
  #   FCAN_CODEGEN=/abs/path/fcan_codegen west twister -T apps
  #   FCAN_CODEGEN_FROM_SOURCE=ON west twister -T apps
  # twister's --extra-args=-D... does not.
  filter: CONFIG_FIBRIL_CAN
  # Each scenario names its own board: twister joins a list under `common`
  # with the scenario's, so a board listed here would also be tried with
  # every other board's snippets.

tests:
  app.node.rc26_air:
    platform_allow:
      - fibril_rc26_mainair_v01
    integration_platforms:
      - fibril_rc26_mainair_v01
    tags:
      - fibril_can
      - can
      - hub
      - usb
    # Semicolons, not two SNIPPET= entries: twister turns each extra_args
    # entry into one -D, and CMake reads SNIPPET as a list.
    extra_args:
      - SNIPPET=rc26-mainair-usb;rc26-air

  app.node.rc26_robstride:
    platform_allow:
      - fibril_rc26_mainair_v01
    integration_platforms:
      - fibril_rc26_mainair_v01
    tags:
      - fibril_can
      - can
      - hub
      - usb
      - motor
    extra_args:
      - SNIPPET=rc26-mainair-usb;rc26-robstride

  app.node.rc26_odrive:
    platform_allow:
      - fibril_rc26_mainair_v01
    integration_platforms:
      - fibril_rc26_mainair_v01
    tags:
      - fibril_can
      - can
      - hub
      - usb
      - motor
    extra_args:
      - SNIPPET=rc26-mainair-usb;rc26-odrive

  app.node.rc26_main:
    platform_allow:
      - fibril_rc26_mainair_v01
    integration_platforms:
      - fibril_rc26_mainair_v01
    tags:
      - fibril_can
      - can
      - hub
      - usb
      - motor
    extra_args:
      - SNIPPET=rc26-mainair-usb;rc26-main

  app.node.rc26_main_odom:
    platform_allow:
      - fibril_rc26_mainair_v01
    integration_platforms:
      - fibril_rc26_mainair_v01
    tags:
      - fibril_can
      - can
      - hub
      - usb
      - motor
      - encoder
      - imu
    extra_args:
      - SNIPPET=rc26-mainair-usb;rc26-main;rc26-odom

  app.node.miniv4_md_qdec4:
    platform_allow:
      - fibril_robomaster_miniv4
    integration_platforms:
      - fibril_robomaster_miniv4
    tags:
      - fibril_can
      - can
      - motor
      - encoder
    extra_args:
      - SNIPPET=miniv4-can;miniv4-md-qdec4

  app.node.miniv4_usb_md_qdec4:
    platform_allow:
      - fibril_robomaster_miniv4
    integration_platforms:
      - fibril_robomaster_miniv4
    tags:
      - fibril_can
      - can
      - hub
      - usb
      - motor
      - encoder
    extra_args:
      - SNIPPET=miniv4-usb;miniv4-md-qdec4

  app.node.miniv4_md_rotor8:
    platform_allow:
      - fibril_robomaster_miniv4
    integration_platforms:
      - fibril_robomaster_miniv4
    tags:
      - fibril_can
      - can
      - motor
      - encoder
    extra_args:
      - SNIPPET=miniv4-can;miniv4-md-rotor8

  app.node.miniv4_md_vesc8:
    platform_allow:
      - fibril_robomaster_miniv4
    integration_platforms:
      - fibril_robomaster_miniv4
    tags:
      - fibril_can
      - can
      - motor
      - encoder
      - vesc
    extra_args:
      - SNIPPET=miniv4-can;miniv4-md-vesc8

  app.node.miniv4_md_amt4:
    platform_allow:
      - fibril_robomaster_miniv4
    integration_platforms:
      - fibril_robomaster_miniv4
    tags:
      - fibril_can
      - can
      - motor
      - encoder
      - rs485
    extra_args:
      - SNIPPET=miniv4-can;miniv4-md-amt4

  app.node.miniv4_md_rotor8_adc:
    platform_allow:
      - fibril_robomaster_miniv4
    integration_platforms:
      - fibril_robomaster_miniv4
    tags:
      - fibril_can
      - can
      - motor
      - encoder
      - adc
    extra_args:
      - SNIPPET=miniv4-can;miniv4-md-rotor8;miniv4-adc

  app.node.miniv4_md_qdec4_adc:
    platform_allow:
      - fibril_robomaster_miniv4
    integration_platforms:
      - fibril_robomaster_miniv4
    tags:
      - fibril_can
      - can
      - motor
      - encoder
      - adc
    extra_args:
      - SNIPPET=miniv4-can;miniv4-md-qdec4;miniv4-adc
```

## prj.conf
```kconfig
# Copyright (c) 2026
# SPDX-License-Identifier: Apache-2.0
#
# What every fibril_can slave needs. The per-robot half (which schema, which
# node id, which valves, which CAN bus) comes from a snippet.

CONFIG_FIBRIL_CAN=y
CONFIG_FIBRIL_CAN_NODE=y
CONFIG_FCAN_TRANSPORT=y

# The generated wrapper and the functions are C++17. A full standard library
# is not a preference: the wrapper's service registration is std::function and
# its topic readers are std::optional, neither of which MINIMAL_LIBCPP has.
CONFIG_CPP=y
CONFIG_STD_CPP17=y
CONFIG_REQUIRES_FULL_LIBCPP=y

# main.c uses the scheduler_wait / fcan_poll pair; the wake bits come from
# notify_tx_pending (commits and queued control frames), TX complete, and the
# 1 ms k_timer that bounds the function ticks.
CONFIG_FCAN_ZEPHYR_EVENT_WAKE=y

CONFIG_CAN=y
CONFIG_CAN_FD_MODE=y

# boot_id is the ID-conflict tiebreaker and the T_listen jitter seed, so two
# boards coming up together must not draw the same value.
CONFIG_ENTROPY_GENERATOR=y

CONFIG_HEAP_MEM_POOL_SIZE=4096
CONFIG_MAIN_STACK_SIZE=4096

CONFIG_LOG=y
```

## miniv4-usb-no-protocol-error-irq.conf
```kconfig
CONFIG_CAN_MCAN_PROTOCOL_ERROR_IRQ=n
```

## vesc-diagnostics.conf
```kconfig
# VESC hardware bring-up only. Normal node builds must not include this file.
CONFIG_MOTOR_VESC_DIAGNOSTICS=y
CONFIG_MOTOR_VESC_DIAGNOSTICS_FIRST_FRAMES=3
CONFIG_MOTOR_VESC_DIAGNOSTICS_STATUS_PERIOD_MS=100
CONFIG_MOTOR_VESC_DIAGNOSTICS_SUMMARY_MS=1000
CONFIG_LOG_BUFFER_SIZE=8192
```

## vesc-hardware-selftest.conf
```kconfig
# VESC hardware bring-up only. Normal node builds must not include this file.
CONFIG_MOTOR_VESC_DIAGNOSTICS=y
CONFIG_MOTOR_VESC_DIAGNOSTICS_FIRST_FRAMES=3
CONFIG_MOTOR_VESC_DIAGNOSTICS_SUMMARY_MS=1000
CONFIG_LOG_BUFFER_SIZE=4096
CONFIG_FIBRIL_CAN_NODE_VESC_HARDWARE_SELFTEST=y
```

## src/main.c
```c
/*
 * Copyright (c) 2026
 * SPDX-License-Identifier: Apache-2.0
 *
 * fibril_can slave entry point.
 *
 * Names no block type and no transport. The functions this image carries
 * register themselves in the fibril_fcan_func section (see
 * include/fibril_can_node/func.h), and how their frames reach the bus is
 * decided by the devicetree (see include/fcan_transport/transport.h). Adding
 * a valve, or putting the same node behind a CAN hub, does not touch this
 * file.
 */

#include <stdint.h>

#include <zephyr/kernel.h>
#include <zephyr/logging/log.h>
#include <zephyr/random/random.h>

#include <fibril_can/fcan.h>
#include <fibril_can/fcan_protocol.h>

#include <fcan_transport/transport.h>
#include <fibril_can_node/func.h>

#include "schema_gen.h"

/* The C emitter puts these in schema_blob.c but does not declare them. */
extern const uint8_t fcan_schema_blob[];
extern const size_t fcan_schema_blob_len;
extern const uint64_t fcan_schema_hash;

LOG_MODULE_REGISTER(fibril_node, CONFIG_APP_LOG_LEVEL);

#define MASTER_LOST_US 300000U /* SPEC §5.11 */

/* fcan_init carves every variable-length buffer from this once. Sized with
 * headroom rather than tuned: the image can gain a block type without a
 * matching edit here, and running out is a boot failure, not a slow path.
 */
K_HEAP_DEFINE(fcan_heap, 16 * 1024);

static void * heap_alloc(size_t size, size_t align, void * ctx)
{
  ARG_UNUSED(ctx);
  return k_heap_aligned_alloc(&fcan_heap, align, size, K_NO_WAIT);
}

static void run_ticks(void)
{
  STRUCT_SECTION_FOREACH(fibril_fcan_func, f) {
    if (f->tick != NULL) {
      f->tick();
    }
  }
}

int main(void)
{
  /* Indexed by the codegen's FCAN_ARRAY_*, so a function fills its own slot
   * whatever order the schema puts the block arrays in.
   */
  uint8_t counts[FCAN_NUM_BLOCK_ARRAYS] = {0};
  bool any_tick = false;

  STRUCT_SECTION_FOREACH(fibril_fcan_func, f) {
    int ret = (f->init != NULL) ? f->init() : 0;

    if (ret != 0) {
      LOG_ERR("%s: init failed (%d)", f->name, ret);
      return ret;
    }

    counts[f->array] = f->count;
    any_tick = any_tick || (f->tick != NULL);
    LOG_INF("%s: %u instance(s) on block array %u", f->name, f->count, f->array);
  }

  int rc = fcan_transport_init();

  if (rc != 0) {
    return rc;
  }

  /* fcan_node_storage_size() is a runtime call because fcan_node_t is opaque,
   * so the node cannot be a static array. 8-byte alignment satisfies the
   * seqlock and u64 hash fields the runtime keeps inside.
   */
  fcan_node_t * node =
    k_heap_aligned_alloc(&fcan_heap, 8, fcan_node_storage_size(), K_NO_WAIT);

  if (node == NULL) {
    LOG_ERR("fcan_heap OOM allocating node (%u bytes)", (unsigned)fcan_node_storage_size());
    return -ENOMEM;
  }

  fcan_config_t cfg = {
    /* Build-time for now. On a board with a DIP switch or a config ROM this
     * is read at boot so that identical boards share one image.
     */
    .node_id = CONFIG_FIBRIL_NODE_ID,
    .boot_id = sys_rand32_get(),
    .schema_blob = fcan_schema_blob,
    .schema_blob_len = (uint16_t)fcan_schema_blob_len,
    .schema_hash = fcan_schema_hash,
    .protocol_version = FCAN_PROTOCOL_VERSION,
    .block_count = FCAN_NUM_BLOCK_ARRAYS,
    .instance_counts = counts,
    .limits =
      {
        .max_frames = FCAN_MAX_FRAMES,
        .max_copy_entries = FCAN_MAX_COPY_ENTRIES,
        .service_buffer = FCAN_SERVICE_BUFFER,
        .service_reassembly = FCAN_SERVICE_REASSEMBLY,
      },
    .hal = fcan_transport_hal(),
    .allocator = {.alloc = heap_alloc, .ctx = NULL},
    .master_lost_us = MASTER_LOST_US,
  };
  fcan_apply_schema_capacities(&cfg.limits, counts);

  if (fcan_init(node, &cfg) != FCAN_OK) {
    LOG_ERR("fcan_init failed (fault=%d)", (int)fcan_fault(node));
    return -EIO;
  }
  LOG_INF(
    "fcan_init OK: node_id=0x%02x schema_hash=0x%016llx blob_len=%u", cfg.node_id,
    (unsigned long long)fcan_schema_hash, (unsigned)fcan_schema_blob_len);

  if (fcan_register_all(node) != FCAN_OK) {
    LOG_ERR("fcan_register_all failed (fault=%d)", (int)fcan_fault(node));
    return -EIO;
  }
  LOG_INF("fcan_register_all OK");

  /* Before attach, not after. Attaching is what lets frames reach the node —
   * behind a hub the driver thread starts polling it, and a gs_usb build
   * enumerates on the same call — so a service handler could otherwise run
   * while a function is still publishing its initial state and overwrite a
   * just-commanded output. Committing here is not a lost publish: the runtime
   * holds the request until the node is allowed to transmit.
   */
  STRUCT_SECTION_FOREACH(fibril_fcan_func, f) {
    int ret = (f->start != NULL) ? f->start() : 0;

    if (ret != 0) {
      LOG_ERR("%s: start failed (%d)", f->name, ret);
      return ret;
    }
  }

  rc = fcan_transport_attach(node);
  if (rc != 0) {
    return rc;
  }

  LOG_INF("handing over to the transport (periodic ticks %s)", any_tick ? "on" : "off");

  fcan_transport_run(node, any_tick ? run_ticks : NULL);

  return 0;
}
```

## src/main.cpp
```c
/*
 * Copyright (c) 2026
 * SPDX-License-Identifier: Apache-2.0
 *
 * fibril_can slave entry point.
 *
 * Names no block type and no transport. The functions this image carries
 * register themselves in the fibril_fcan_func section (see
 * include/fibril_can_node/func.h), and how their frames reach the bus is
 * decided by the devicetree (see include/fcan_transport/transport.h). Adding
 * a valve, or putting the same node behind a CAN hub, does not touch this
 * file.
 */

#include <cstddef>
#include <cstdint>

#include <zephyr/drivers/watchdog.h>
#include <zephyr/kernel.h>
#include <zephyr/logging/log.h>
#include <zephyr/random/random.h>

#include <fcan_transport/transport.h>
#include <fibril_can_node/func.h>
#include <node_id/node_id.h>

#include "schema_gen.hpp"

LOG_MODULE_REGISTER(fibril_node, CONFIG_APP_LOG_LEVEL);

#define MASTER_LOST_US 300000U /* SPEC §5.11 */

/* The node's storage, and every variable-length buffer fcan_init carves
 * once, come from this. Running out is a boot failure, not a slow path.
 */
K_HEAP_DEFINE(fcan_heap, CONFIG_APP_FCAN_HEAP_SIZE);

static void * heap_alloc(size_t size, size_t align, void * ctx)
{
  ARG_UNUSED(ctx);
  return k_heap_aligned_alloc(&fcan_heap, align, size, K_NO_WAIT);
}

#if defined(CONFIG_APP_WATCHDOG)
static const struct device * const watchdog = DEVICE_DT_GET(DT_ALIAS(watchdog0));
static int watchdog_channel = -1;

static int watchdog_start(void)
{
  struct wdt_timeout_cfg cfg{};

  if (!device_is_ready(watchdog)) {
    LOG_ERR("watchdog not ready");
    return -ENODEV;
  }

  cfg.window.min = 0U;
  cfg.window.max = CONFIG_APP_WATCHDOG_TIMEOUT_MS;
  cfg.flags = WDT_FLAG_RESET_SOC;

  const int channel = wdt_install_timeout(watchdog, &cfg);

  if (channel < 0) {
    LOG_ERR("watchdog timeout not accepted (%d)", channel);
    return channel;
  }

  /* Paused under the debugger, or every breakpoint would reset the board. */
  const int ret = wdt_setup(watchdog, WDT_OPT_PAUSE_HALTED_BY_DBG);

  if (ret != 0) {
    LOG_ERR("watchdog setup failed (%d)", ret);
    return ret;
  }

  watchdog_channel = channel;

  return 0;
}
#endif

static void run_ticks(void)
{
  STRUCT_SECTION_FOREACH(fibril_fcan_func, f) {
    if (f->tick != nullptr) {
      f->tick();
    }
  }

#if defined(CONFIG_APP_WATCHDOG)
  if (watchdog_channel >= 0) {
    (void)wdt_feed(watchdog, watchdog_channel);
  }
#endif
}

static void run_on_rx(void)
{
  STRUCT_SECTION_FOREACH(fibril_fcan_func, f) {
    if (f->on_rx != nullptr) {
      f->on_rx();
    }
  }
}

int main(void)
{
  /* Indexed by fcan_gen::<type>::block_array_index, so a function fills its
   * own slot whatever order the schema puts the block arrays in.
   *
   * Static because config_user documents that the pointer has to outlive the
   * node, and fcan_transport_run() does return on a backend whose frames a
   * driver thread drives. The runtime copies the counts today, so an
   * automatic would work; one byte of .bss is cheaper than depending on that.
   */
  static uint8_t counts[fcan_gen::num_block_arrays];
  bool any_tick = false;
  bool any_on_rx = false;

  STRUCT_SECTION_FOREACH(fibril_fcan_func, f) {
    int ret = (f->init != nullptr) ? f->init() : 0;

    if (ret != 0) {
      LOG_ERR("%s: init failed (%d)", f->name, ret);
      return ret;
    }

    counts[f->array] = f->count;
    any_tick = any_tick || (f->tick != nullptr);
    any_on_rx = any_on_rx || (f->on_rx != nullptr);
    LOG_INF("%s: %u instance(s) on block array %u", f->name, f->count, f->array);
  }

  int rc = fcan_transport_init();

  if (rc != 0) {
    return rc;
  }

  fcan_gen::config_user user{};

#if defined(CONFIG_FIBRIL_NODE_ID_SWITCH)
  rc = node_id_read(&user.node_id);
  if (rc != 0) {
    LOG_ERR("could not read the node id switch (%d)", rc);
    return rc;
  }
#else
  user.node_id = CONFIG_FIBRIL_NODE_ID;
#endif
  user.boot_id = sys_rand32_get();
  user.instance_counts = counts;
  user.hal = fcan_transport_hal();
  user.allocator = {.alloc = heap_alloc, .ctx = nullptr};
  user.master_lost_us = MASTER_LOST_US;

  /* The schema-determined half of the config, and the capacities derived from
   * the counts, come from the generated header.
   */
  fcan_config_t cfg = fcan_gen::make_config(user);

  /* The library makes the node, not this file, so that the functions can read
   * its state without this file having to hand it over.
   */
  fcan_node_t * node = nullptr;

  rc = fibril_fcan_node_init(&cfg, &node);
  if (rc != 0) {
    return rc;
  }
  LOG_INF(
    "fcan_init OK: node_id=0x%02x schema_hash=0x%016llx blob_len=%u", user.node_id,
    (unsigned long long)fcan_schema_hash, (unsigned)fcan_schema_blob_len);

#if defined(CONFIG_SYS_HEAP_RUNTIME_STATS)
  /* Nothing allocates from fcan_heap after fcan_init, so this is the peak. */
  struct sys_memory_stats heap_stats;

  sys_heap_runtime_stats_get(&fcan_heap.heap, &heap_stats);
  LOG_INF(
    "fcan_heap: %u of %u bytes used", (unsigned)heap_stats.allocated_bytes,
    (unsigned)CONFIG_APP_FCAN_HEAP_SIZE);
#endif

  /* Also what installs the service and parameter dispatchers the functions
   * register their handlers into, so it has to run before any start hook.
   */
  if (fcan_gen::register_all(node) != FCAN_OK) {
    LOG_ERR("register_all failed (fault=%d)", (int)fcan_fault(node));
    return -EIO;
  }
  LOG_INF("register_all OK");

  /* Before attach, not after. Attaching is what lets frames reach the node —
   * behind a hub the driver thread starts polling it, and a gs_usb build
   * enumerates on the same call — so a service handler could otherwise run
   * while a function is still publishing its initial state and overwrite a
   * just-commanded output. Committing here is not a lost publish: the runtime
   * holds the request until the node is allowed to transmit.
   */
  STRUCT_SECTION_FOREACH(fibril_fcan_func, f) {
    int ret = (f->start != nullptr) ? f->start() : 0;

    if (ret != 0) {
      LOG_ERR("%s: start failed (%d)", f->name, ret);
      return ret;
    }
  }

  rc = fcan_transport_attach(node);
  if (rc != 0) {
    return rc;
  }

#if defined(CONFIG_APP_WATCHDOG)
  /* Last, so that nothing before the first tick has to fit in the timeout. */
  if (any_tick) {
    rc = watchdog_start();
    if (rc != 0) {
      return rc;
    }
  } else {
    LOG_WRN("no function ticks, so nothing feeds the watchdog; left off");
  }
#endif

  LOG_INF("handing over to the transport (periodic ticks %s)", any_tick ? "on" : "off");

  fcan_transport_run(node, any_tick ? run_ticks : nullptr, any_on_rx ? run_on_rx : nullptr);

  return 0;
}
```
