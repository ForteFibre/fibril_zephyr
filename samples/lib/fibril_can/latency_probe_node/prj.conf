## CMakeLists.txt
```
# SPDX-License-Identifier: Apache-2.0
#
# Zephyr sample: fibril_can_benchmark latency-probe slave node.
#
# Runs fcan_codegen against fibril_can_benchmark/schema/latency_probe.yaml and
# builds a Zephyr application around fcan_runtime + the generated C99 wrappers.
# The application is the MCU-side counterpart of the reference host slave in
# fibril_can_benchmark/src/host_latency_slave.cpp; both must obey the contract
# in fibril_can_benchmark/docs/firmware-requirements.md.

cmake_minimum_required(VERSION 3.20.0)
find_package(Zephyr REQUIRED HINTS $ENV{ZEPHYR_BASE})

project(fibril_can_latency_probe_node LANGUAGES C)

if(NOT ZEPHYR_FIBRIL_CAN_MODULE_DIR)
  message(FATAL_ERROR
    "ZEPHYR_FIBRIL_CAN_MODULE_DIR is not set — is the fibril_can module on "
    "the west manifest and is CONFIG_FIBRIL_CAN=y?")
endif()

include(${ZEPHYR_FIBRIL_CAN_MODULE_DIR}/zephyr/cmake/fcan_invoke_codegen.cmake)

set(FCAN_LATENCY_PROBE_SCHEMA
  "${ZEPHYR_FIBRIL_CAN_MODULE_DIR}/fibril_can_benchmark/schema/latency_probe.yaml"
  CACHE FILEPATH "Schema YAML to feed into fcan_codegen")

fcan_invoke_codegen(
  SCHEMA     "${FCAN_LATENCY_PROBE_SCHEMA}"
  OUTPUT_DIR "${CMAKE_CURRENT_BINARY_DIR}/schema_gen"
  BASE_NAME  schema_gen)

target_sources(app PRIVATE
  src/main.c
  src/probe_logic.c)

target_include_directories(app PRIVATE
  ${CMAKE_CURRENT_SOURCE_DIR}/src)
```

## sample.yaml
```
sample:
  name: fibril_can latency probe slave
  description: >-
    Zephyr implementation of the fibril_can_benchmark latency-probe MCU
    firmware contract. Runs fcan_codegen against
    fibril_can_benchmark/schema/latency_probe.yaml at build time; the
    application copies received ping seq/t_master_send_ns into the S2M echo
    stream in the same tick, following firmware-requirements §3.1.

tests:
  sample.lib.fibril_can.latency_probe_node:
    tags:
      - fibril_can
      - fibril_can_benchmark
      - can
    filter: CONFIG_FIBRIL_CAN and dt_chosen_enabled("zephyr,canbus")
    harness: console
    harness_config:
      type: multi_line
      ordered: true
      regex:
        - "fcan_latency_probe: fcan_init OK"
        - "fcan_latency_probe: fcan_register_all OK"
        - "fcan_latency_probe: entering main loop"
    integration_platforms:
      - native_sim
      - fibril_robomaster_miniv1
    # Twister needs to know where fcan_codegen lives before it can build this
    # sample. Set FCAN_CODEGEN in the environment before invoking twister:
    #   FCAN_CODEGEN=/abs/path/fcan_codegen twister -T fibril_zephyr/samples/lib/fibril_can/latency_probe_node
    # or pass --extra-args=-DFCAN_CODEGEN=... to twister directly.
```

## prj.conf
```kconfig
# SPDX-License-Identifier: Apache-2.0

# --- fibril_can slave runtime
CONFIG_FIBRIL_CAN=y

# --- event-driven scheduler wake for fcan_zephyr_can_hal. The probe main loop
#     runs on a fixed periodic tick (K_TIMEOUT_ABS_TICKS) so scheduler_wait is
#     not called; enabling the option keeps notify_tx_pending / TX-complete
#     wired so the runtime learns about TX-ready promptly without changing
#     the tick cadence.
CONFIG_FCAN_ZEPHYR_EVENT_WAKE=y

# --- CAN driver + FD framing (mandatory per firmware-requirements §9).
CONFIG_CAN=y
CONFIG_CAN_FD_MODE=y

# --- entropy for boot_id (SPEC §5.3 T_listen jitter seed + ID conflict tiebreaker).
CONFIG_ENTROPY_GENERATOR=y

# --- runtime allocation. K_HEAP_DEFINE in main.c carves its own arena; the
#     system pool covers the CAN driver / entropy driver's startup allocations.
CONFIG_HEAP_MEM_POOL_SIZE=4096

# --- main thread runs the 1 kHz probe tick (on_tick -> fcan_poll).
CONFIG_MAIN_STACK_SIZE=4096

# --- kernel tick precision. 10 kHz gives the sleep_until path 100 μs
#     granularity, which matches the §5 hot-path budget (echo commit dwell
#     ≤ 100 μs @ 1 kHz tick). native_sim defaults to 100 Hz otherwise.
CONFIG_SYS_CLOCK_TICKS_PER_SEC=10000

# --- logging: no LOG in the hot path (see main.c status thread), so IMMEDIATE
#     mode is safe. Kept on so the initial banner and state-transition print
#     from the low-priority status thread are visible.
CONFIG_LOG=y
CONFIG_LOG_MODE_IMMEDIATE=y
CONFIG_BOOT_BANNER=y
```

## boards/native_sim.conf
```kconfig
# SPDX-License-Identifier: Apache-2.0
#
# native_sim has no hardware entropy source. CONFIG_TEST_RANDOM_GENERATOR
# gives sys_rand32_get() a predictable PRNG so the sample boots on this
# platform. Confined to native_sim so the deterministic seed never leaks
# into a physical-board build (boot_id would become predictable).
CONFIG_TEST_RANDOM_GENERATOR=y
```

## boards/fibril_robomaster_miniv1.overlay
```dts
/*
 * SPDX-License-Identifier: Apache-2.0
 *
 * latency_probe_node bring-up on the Fibril RoboMaster Mini V1. The board DTS
 * already routes fdcan1 pinctrl to PD0/PD1 and sources its kernel clock from
 * PLL_Q (80 MHz); this overlay enables the controller, picks a bitrate,
 * publishes it as zephyr,canbus, and turns on the on-chip RNG so
 * fcan_config_t::boot_id has a real entropy source.
 *
 * Bitrate values here are the ones the implementer README reports in the
 * "physical layer" section (firmware-requirements §9). Change both properties
 * together when swapping to a different benchmark configuration.
 */

/ {
	chosen {
		zephyr,canbus = &fdcan1;
	};
};

&fdcan1 {
	status = "okay";
	bitrate = <1000000>;
	bitrate-data = <5000000>;
};

&rng {
	status = "okay";
};
```

## src/main.c
```c
/*
 * SPDX-License-Identifier: Apache-2.0
 *
 * Zephyr entry point for the fibril_can_benchmark latency-probe slave sample.
 * Implements the MCU firmware contract in
 * fibril_can_benchmark/docs/firmware-requirements.md; the on-wire behaviour
 * matches the reference host slave (host_latency_slave.cpp) byte-for-byte.
 *
 * Design points
 * -------------
 * - Main loop order is `probe_logic_tick -> fcan_poll -> sleep`,
 *   the §3.4.1 recommendation for latency-critical firmware: change-driven
 *   echo commits during the tick are emitted by the same fcan_poll pass.
 * - Hot path holds no LOG / printf / malloc calls (§5). Status logging runs
 *   on a lower-priority thread that samples atomic HAL counters once a
 *   second.
 * - master_lost_us = 0 (§7) so the echo stream does not stall when a master
 *   heartbeat slips.
 *
 * What this sample does NOT verify
 * --------------------------------
 * - Round-trip against fibril_can_bridge / probe_node.py — that needs vcan
 *   and a ROS 2 workspace, both outside the Zephyr harness. Use the reference
 *   host slave for that setup.
 * - Real-hardware timing budgets. native_sim's cycle rate is coarse; §4.2's
 *   1 μs resolution requirement is met on the MCU targets (fdcan cycle
 *   counter runs at CPU clock) but not on native_sim.
 */

#include <stdint.h>
#include <string.h>

#include <zephyr/device.h>
#include <zephyr/drivers/can.h>
#include <zephyr/kernel.h>
#include <zephyr/logging/log.h>
#include <zephyr/random/random.h>
#include <zephyr/sys/time_units.h>

#include <fibril_can/fcan.h>
#include <fibril_can/fcan_protocol.h>

#include <fibril_can_zephyr/can_hal.h>

#include "schema_gen.h"
#include "probe_logic.h"

extern const uint8_t  fcan_schema_blob[];
extern const size_t   fcan_schema_blob_len;
extern const uint64_t fcan_schema_hash;

LOG_MODULE_REGISTER(fcan_latency_probe, LOG_LEVEL_INF);

#define CAN_NODE    DT_CHOSEN(zephyr_canbus)
#define CAN_BUS_DEV DEVICE_DT_GET(CAN_NODE)

/* §6: probe launch defaults --node-id to 0x20 — match it here so the sample
 * is a drop-in target for the reference launch. Override without patching
 * source by passing -DEXTRA_CFLAGS=-DNODE_ID=0x?? on the west build
 * line. */
#ifndef NODE_ID
#define NODE_ID     0x20
#endif

#define MASTER_LOST_US 0U  /* §7: disabled by default. */

/* §3.4.3 — higher tick rate reduces uniform[0, tick_period] detection lag.
 * 1 kHz matches the schema's echo period_us so periodic phase noise is
 * minimal; 5 kHz gave the biggest additional improvement in the README
 * "Finding" table. Override via -DTICK_HZ=5000 on the build line. */
#ifndef TICK_HZ
#define TICK_HZ     1000U
#endif

/* 1: also run the tick as soon as a ping lands (the runtime's notify_rx),
 * instead of only at the next tick boundary. Compare the echo_change latency
 * with 0 and 1 to see what waking on arrival buys. Override via
 * -DWAKE_ON_RX=1 on the build line. */
#ifndef WAKE_ON_RX
#define WAKE_ON_RX  0
#endif

K_HEAP_DEFINE(fcan_heap, 8 * 1024);

static void *heap_alloc(size_t size, size_t align, void *ctx)
{
	ARG_UNUSED(ctx);
	return k_heap_aligned_alloc(&fcan_heap, align, size, K_NO_WAIT);
}

static const char *state_str(fcan_node_state_t s)
{
	switch (s) {
	case FCAN_STATE_UNPROVISIONED: return "UNPROVISIONED";
	case FCAN_STATE_PROVISIONED:   return "PROVISIONED";
	case FCAN_STATE_RUNNING:       return "RUNNING";
	case FCAN_STATE_FAULT:         return "FAULT";
	default:                       return "?";
	}
}

/* Handed to the status thread once main() finishes bring-up. Reads happen
 * from a lower-priority thread; the values themselves are word-sized so a
 * torn read is at worst a stale count in the log line. */
static fcan_node_t                *g_node;
static struct fcan_zephyr_can_hal *g_hal;

static void status_thread_entry(void *a, void *b, void *c)
{
	ARG_UNUSED(a);
	ARG_UNUSED(b);
	ARG_UNUSED(c);

	fcan_node_state_t last = FCAN_STATE_UNPROVISIONED;
	while (true) {
		if (g_node != NULL && g_hal != NULL) {
			const fcan_node_state_t s = fcan_state(g_node);
			if (s != last) {
				LOG_INF("state: %s -> %s (fault=%d)",
					state_str(last), state_str(s),
					(int)fcan_fault(g_node));
				last = s;
			}
			LOG_INF("alive: state=%s tx=%u tx_drops=%u rx=%u",
				state_str(s), g_hal->tx_frames,
				g_hal->tx_drops, g_hal->rx_frames);
		}
		k_sleep(K_SECONDS(1));
	}
}
K_THREAD_DEFINE(status_tid, 1024, status_thread_entry, NULL, NULL, NULL,
		7, 0, 0);

#if WAKE_ON_RX
static void tick_timer_expiry(struct k_timer *timer)
{
	fcan_notify_tx_ready(k_timer_user_data_get(timer));
}
#endif

int main(void)
{
	const struct device *can_dev = CAN_BUS_DEV;
	static struct fcan_zephyr_can_hal hal;

	if (!device_is_ready(can_dev)) {
		LOG_ERR("CAN device %s not ready", can_dev->name);
		return -ENODEV;
	}

	int rc = can_set_mode(can_dev, CAN_MODE_FD);
	if (rc != 0) {
		LOG_ERR("can_set_mode(FD) rc=%d", rc);
		return rc;
	}

	rc = fcan_zephyr_can_hal_init(&hal, can_dev);
	if (rc != 0) {
		return rc;
	}

	rc = can_start(can_dev);
	if (rc != 0) {
		LOG_ERR("can_start rc=%d", rc);
		return rc;
	}

	fcan_node_t *node = k_heap_aligned_alloc(&fcan_heap, 8,
						 fcan_node_storage_size(),
						 K_NO_WAIT);
	if (node == NULL) {
		LOG_ERR("fcan_heap OOM allocating node (%u bytes)",
			(unsigned)fcan_node_storage_size());
		return -ENOMEM;
	}

	/* Single LatencyProbe instance matches
	 * fibril_can_benchmark/schema/latency_probe.yaml `instances: [{count:1}]`.
	 *
	 * Indexed by FCAN_ARRAY_*, never positionally: the block array order
	 * is derived from the schema, so a positional initialiser keeps
	 * compiling while handing a count to the wrong block.
	 */
	static const uint8_t counts[FCAN_NUM_BLOCK_ARRAYS] = {
		[FCAN_ARRAY_LATENCYPROBE] = 1U,
	};

	fcan_config_t cfg = {
		.node_id = NODE_ID,
		.boot_id = sys_rand32_get(),
		.schema_blob = fcan_schema_blob,
		.schema_blob_len = (uint16_t)fcan_schema_blob_len,
		.schema_hash = fcan_schema_hash,
		.protocol_version = FCAN_PROTOCOL_VERSION,
		.block_count = FCAN_NUM_BLOCK_ARRAYS,
		.instance_counts = counts,
		.limits = {
			.max_frames = FCAN_MAX_FRAMES,
			.max_copy_entries = FCAN_MAX_COPY_ENTRIES,
			.service_buffer = FCAN_SERVICE_BUFFER,
			.service_reassembly = FCAN_SERVICE_REASSEMBLY,
		},
		.hal = fcan_zephyr_can_hal_get(&hal),
		.allocator = {.alloc = heap_alloc, .ctx = NULL},
		.master_lost_us = MASTER_LOST_US,
	};
	fcan_apply_schema_capacities(&cfg.limits, counts);

	if (fcan_init(node, &cfg) != FCAN_OK) {
		LOG_ERR("fcan_init failed (fault=%d)", (int)fcan_fault(node));
		return -EIO;
	}
	LOG_INF("fcan_init OK: node_id=0x%02x schema_hash=0x%016llx blob_len=%u tick=%u Hz",
		cfg.node_id, (unsigned long long)fcan_schema_hash,
		(unsigned)fcan_schema_blob_len, (unsigned)TICK_HZ);

	fcan_zephyr_can_hal_attach_node(&hal, node);

	if (fcan_register_all(node) != FCAN_OK) {
		LOG_ERR("fcan_register_all failed (fault=%d)",
			(int)fcan_fault(node));
		return -EIO;
	}
	LOG_INF("fcan_register_all OK");

	probe_logic_init();

	g_node = node;
	g_hal = &hal;

	LOG_INF("entering main loop");

	/* K_TIMEOUT_ABS_TICKS takes int64_t; k_ticks_t narrows to uint32_t on
	 * some configs, so keep both accumulators as int64_t. */
	const int64_t period_ticks =
		(int64_t)k_us_to_ticks_ceil64(1000000ULL / TICK_HZ);
	int64_t next = k_uptime_ticks();
#if WAKE_ON_RX
	/* The wait below returns on the HAL's wake event; the timer posts it at
	 * every tick boundary, a ping posts it on arrival. */
	static struct k_timer tick_timer;

	k_timer_init(&tick_timer, tick_timer_expiry, NULL);
	k_timer_user_data_set(&tick_timer, node);
	k_timer_start(&tick_timer, K_TICKS(period_ticks), K_TICKS(period_ticks));
	fcan_zephyr_can_hal_set_wake_on_rx(&hal, true);

	while (true) {
		fcan_zephyr_can_hal_scheduler_wait(&hal, node);
		const bool arrived = fcan_zephyr_can_hal_take_rx(&hal);
		const bool due = (k_uptime_ticks() - next) >= 0;

		if (arrived || due) {
			probe_logic_tick();
		}
		if (due) {
			next += period_ticks;
		}
		fcan_poll(node);
	}
#else
	while (true) {
		probe_logic_tick();
		fcan_poll(node);

		next += period_ticks;
		k_sleep(K_TIMEOUT_ABS_TICKS(next));
	}
#endif
	/* unreachable */
}
```

## src/probe_logic.c
```c
/*
 * SPDX-License-Identifier: Apache-2.0
 *
 * On-tick copy of the received ping into the two S2M echo streams. Wire-visible
 * behaviour tracks fibril_can_benchmark/docs/firmware-requirements.md:
 *
 *   §3.1  seq / t_master_send_ns are copied inside the same tick as the ping
 *         arrival — no cross-tick buffering.
 *   §3.2  ticks with no ping yet emit zeros so the probe can filter warmup
 *         samples by seq == 0.
 *   §3.3  latencyprobe_ping_read() collapses multiple frames per tick to the
 *         last one; nothing extra to do here.
 *   §3.4  periodic echo fires every tick regardless of ping arrival; the
 *         runtime scheduler handles the actual next_due gate.
 *   §4    t_slave_recv_us is stamped as soon as we know we have a fresh ping;
 *         t_slave_send_us is stamped immediately before commit.
 *
 * No heap allocation, no logging, no floating point — this runs on the hot
 * path and firmware-requirements §5 forbids all three.
 */

#include "probe_logic.h"

#include <stdbool.h>
#include <stdint.h>

#include <zephyr/kernel.h>
#include <zephyr/sys/time_units.h>

#include "schema_gen.h"

#define PROBE_INST 0U

/* Track the last seq we committed to echo_change so we only fire the
 * app-trigger stream when something new arrives. `any_committed` guards the
 * first ping (seq could legitimately be 0). */
static uint32_t last_committed_seq;
static bool     any_committed;

/* Monotonic microseconds. On a real MCU the DWT / SysTick cycle counter
 * runs at CPU frequency and easily satisfies §4.2's 1 μs resolution; on
 * native_sim the cycle rate is lower — good enough for smoke testing but
 * do not treat those samples as production timing.
 *
 * The 32-bit wrap (~71 min) is intentional — §4.2 states the probe side
 * handles wraparound in its differences, so the slave just hands over the
 * low 32 bits. */
static inline uint32_t now_us(void)
{
	return k_cyc_to_us_floor32(k_cycle_get_32());
}

void probe_logic_init(void)
{
	last_committed_seq = 0U;
	any_committed = false;
}

void probe_logic_tick(void)
{
	latencyprobe_ping_t ping;
	const bool got_ping = latencyprobe_ping_read(PROBE_INST, &ping);
	const uint32_t t_recv = got_ping ? now_us() : 0U;

	latencyprobe_echo_t *out = latencyprobe_echo_begin(PROBE_INST);
	if (out != NULL) {
		if (got_ping) {
			out->seq = ping.seq;
			out->t_master_send_ns = ping.t_master_send_ns;
			out->t_slave_recv_us = t_recv;
		} else {
			out->seq = 0U;
			out->t_master_send_ns = 0U;
			out->t_slave_recv_us = 0U;
		}
		out->t_slave_send_us = now_us();
		latencyprobe_echo_commit(PROBE_INST);
	}

	if (got_ping && (!any_committed || ping.seq != last_committed_seq)) {
		latencyprobe_echo_change_t *chg = latencyprobe_echo_change_begin(PROBE_INST);
		if (chg != NULL) {
			chg->seq = ping.seq;
			chg->t_master_send_ns = ping.t_master_send_ns;
			chg->t_slave_recv_us = t_recv;
			chg->t_slave_send_us = now_us();
			latencyprobe_echo_change_commit(PROBE_INST);
		}
		last_committed_seq = ping.seq;
		any_committed = true;
	}
}
```

## src/probe_logic.h
```c
/*
 * SPDX-License-Identifier: Apache-2.0
 */
#ifndef LATENCY_PROBE_LOGIC_H_
#define LATENCY_PROBE_LOGIC_H_

void probe_logic_init(void);

/* Same-tick copy of the latest ping into echo (periodic) and echo_change
 * (app-trigger). Must run under the fcan runtime's owning thread — see
 * main.c for the probe_logic_tick -> fcan_poll order that
 * firmware-requirements §3.4.1 recommends. */
void probe_logic_tick(void);

#endif /* LATENCY_PROBE_LOGIC_H_ */
```
