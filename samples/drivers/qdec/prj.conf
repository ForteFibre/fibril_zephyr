## CMakeLists.txt
```
# SPDX-License-Identifier: Apache-2.0

cmake_minimum_required(VERSION 3.20.0)
find_package(Zephyr REQUIRED HINTS $ENV{ZEPHYR_BASE})

project(qdec_read LANGUAGES C)

target_sources(app PRIVATE src/main.c)
```

## sample.yaml
```
sample:
  name: Quadrature encoder read
  description: Poll quadrature encoders decoded by an STM32 timer and log their state.

tests:
  sample.drivers.qdec:
    tags:
      - drivers
      - encoder
    filter: dt_compat_enabled("fibril,stm32-qdec")
    harness: console
    # A console harness without a configuration is rejected when twister loads
    # the testsuite, so the sample would not even be discovered.
    harness_config:
      type: multi_line
      ordered: true
      regex:
        - "counts per revolution"
        - "pos=-?\\d+ \\(-?\\d+\\.\\d+ rev\\)"
```

## prj.conf
```kconfig
# SPDX-License-Identifier: Apache-2.0

CONFIG_ENCODER=y

CONFIG_LOG=y

# Print the boot banner and driver init logs on the console. Immediate mode
# processes each LOG_* call synchronously, so a failure during init still makes
# it out.
CONFIG_BOOT_BANNER=y
CONFIG_PRINTK=y
CONFIG_LOG_MODE_IMMEDIATE=y
```

## boards/fibril_rc26_mainair_v01.overlay
```dts
/*
 * SPDX-License-Identifier: Apache-2.0
 *
 * Quadrature encoder wiring for the Fibril RC26 MainAir V01. The board brings
 * two encoder sockets out to timer inputs: J11 (Encoder3) on TIM3_CH1/CH2
 * (PB4/PB5) and J12 (Encoder4) on TIM4_CH1/CH2 (PB6/PB7). The board DTS leaves
 * both timers off and carries no pinctrl for them, so this overlay supplies
 * both.
 *
 * The node is named "encoder" rather than "qdec" on purpose: the SoC dtsi
 * already declares a disabled "qdec" child under every timer for the upstream
 * st,stm32-qdec driver, and reusing the name would merge into it and drag its
 * st,* properties along. The names carry the silkscreen numbers so that the two
 * devices can be told apart at runtime: the device name comes from the node
 * name, and two identically named nodes produce two devices with one name.
 */

&timers3 {
	status = "okay";

	/* The prescaler divides in encoder mode as well, so anything but 0
	 * would drop counts. The driver refuses to build otherwise.
	 */
	st,prescaler = <0>;

	qdec3: encoder3 {
		compatible = "fibril,stm32-qdec";
		pinctrl-0 = <&tim3_ch1_pb4 &tim3_ch2_pb5>;
		pinctrl-names = "default";

		/* PLACEHOLDER. 512 cycles per revolution at x4 is a common
		 * incremental encoder, but nothing on this board fixes the
		 * value. Set it from the datasheet of the encoder actually
		 * plugged into J11 before trusting any converted units.
		 */
		counts-per-revolution = <2048>;

		/* 16-bit counter, so this bounds the resolvable speed at
		 * 32768 counts per sample. At 2048 counts per revolution that
		 * is 16 revolutions per millisecond, far above the mechanism.
		 */
		poll-interval-us = <1000>;

		status = "okay";
	};
};

&timers4 {
	status = "okay";
	st,prescaler = <0>;

	qdec4: encoder4 {
		compatible = "fibril,stm32-qdec";
		pinctrl-0 = <&tim4_ch1_pb6 &tim4_ch2_pb7>;
		pinctrl-names = "default";
		counts-per-revolution = <2048>;
		poll-interval-us = <1000>;
		status = "okay";
	};
};
```

## src/main.c
```c
/*
 * SPDX-License-Identifier: Apache-2.0
 *
 * Minimal quadrature encoder reader. Enumerates every fibril,stm32-qdec node
 * that the devicetree marks status = "okay" and prints its feedback once per
 * second, along with the position converted to revolutions so that turning the
 * shaft by hand is enough to check the wiring and counts-per-revolution.
 */

#include <inttypes.h>
#include <stdlib.h>

#include <drivers/encoder.h>
#include <zephyr/device.h>
#include <zephyr/devicetree.h>
#include <zephyr/kernel.h>
#include <zephyr/logging/log.h>

LOG_MODULE_REGISTER(qdec_read, LOG_LEVEL_INF);

#define REPORT_PERIOD K_MSEC(1000)

#define ENCODER_LIST_ENTRY(node_id) DEVICE_DT_GET(node_id),
#define CPR_LIST_ENTRY(node_id) DT_PROP(node_id, counts_per_revolution),

static const struct device *const encoders[] = {
	DT_FOREACH_STATUS_OKAY(fibril_stm32_qdec, ENCODER_LIST_ENTRY)
};

/* Counts to physical units is the application's job, so the sample reads the
 * per-device constant out of the devicetree rather than asking the driver.
 */
static const uint32_t counts_per_revolution[] = {
	DT_FOREACH_STATUS_OKAY(fibril_stm32_qdec, CPR_LIST_ENTRY)
};

BUILD_ASSERT(ARRAY_SIZE(encoders) > 0,
	     "Enable at least one fibril,stm32-qdec node in the devicetree");

static void report(const struct device *dev, uint32_t cpr)
{
	struct encoder_feedback fb;
	int ret = encoder_get_feedback(dev, &fb);

	if (ret == -ENODATA) {
		LOG_INF("%s: no sample yet", dev->name);
		return;
	}

	/* Whole revolutions and thousandths separately rather than scaling the
	 * position by 1000 first, which would overflow int64_t at the large
	 * positions encoder_set_position() accepts. Integers rather than a float
	 * so the sample works without CONFIG_CBPRINTF_FP_SUPPORT.
	 */
	int64_t magnitude = (fb.position < 0) ? -fb.position : fb.position;
	const char *sign = (fb.position < 0) ? "-" : "";
	int64_t rev = magnitude / (int64_t)cpr;
	int64_t rev_frac = ((magnitude % (int64_t)cpr) * 1000) / (int64_t)cpr;

	/* Velocity has no value until a second sample gives it an interval to be
	 * measured over, so printing it unconditionally would show a stale number
	 * after every rebuild of the accumulator.
	 */
	if ((fb.valid_mask & ENCODER_FEEDBACK_VELOCITY) != 0U) {
		int32_t mrev_per_s = (int32_t)((int64_t)fb.velocity * 1000 / (int64_t)cpr);

		LOG_INF("%s: pos=%" PRId64 " (%s%" PRId64 ".%03" PRId64 " rev) vel=%d counts/s "
			"(%d.%03d rev/s) interval=%uus epoch=%u",
			dev->name, fb.position, sign, rev, rev_frac, fb.velocity,
			mrev_per_s / 1000, abs(mrev_per_s % 1000), fb.sample_interval_us,
			fb.position_epoch);
	} else {
		LOG_INF("%s: pos=%" PRId64 " (%s%" PRId64 ".%03" PRId64 " rev) vel=n/a epoch=%u",
			dev->name, fb.position, sign, rev, rev_frac, fb.position_epoch);
	}
}


int main(void)
{
	for (size_t i = 0; i < ARRAY_SIZE(encoders); i++) {
		if (!device_is_ready(encoders[i])) {
			LOG_ERR("%s: not ready", encoders[i]->name);
			return -ENODEV;
		}

		LOG_INF("%s: %u counts per revolution", encoders[i]->name,
			counts_per_revolution[i]);
	}

	while (true) {
		for (size_t i = 0; i < ARRAY_SIZE(encoders); i++) {
			report(encoders[i], counts_per_revolution[i]);
		}

		k_sleep(REPORT_PERIOD);
	}

	return 0;
}
```
