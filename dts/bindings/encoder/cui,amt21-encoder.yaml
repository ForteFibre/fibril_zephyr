## dts/bindings/encoder/cui,amt21-encoder.yaml
```yaml
description: |
  Same Sky (CUI Devices) AMT21x absolute encoder node.

  Each encoder on an AMT21 bus is one of these, addressed by its RS485 node
  address.

compatible: "cui,amt21-encoder"

include: base.yaml

on-bus: amt21

properties:
  reg:
    required: true
    description: |
      RS485 node address of the encoder. The low two bits must be zero because
      they encode the command, so valid addresses are the multiples of four,
      giving up to 64 encoders per bus. The factory default is 0x54.

  resolution:
    type: int
    required: true
    enum:
      - 12
      - 14
    description: Absolute position resolution in bits.

  multiturn:
    type: boolean
    description: |
      Set this for multi-turn devices, which answer a second command with a
      signed 14-bit turns counter. The turns counter is reset to zero by a power
      cycle and is not retained.

      The driver reads it only when it rebuilds its accumulator, which is the
      only time it is needed; see poll-turns to read it on every scan.

      Only single-turn devices can store a zero point, so encoder_set_zero()
      returns -ENOTSUP when this property is present.

  poll-turns:
    type: boolean
    description: |
      Read the turns counter on every scan rather than only when the
      accumulator is rebuilt. Requires multiturn.

      The accumulated position comes from the single-turn reading alone, so the
      turns counter is not needed between rebuilds and reading it doubles what
      this encoder costs the bus.

      ENCODER_FEEDBACK_TURNS means exactly this property: without it the bit is
      never set and encoder_feedback.turns always reads zero, including on the
      scan that rebuilds the accumulator and does fetch the counter. That one
      sample is gone again within a scan, so reporting it would offer a bit no
      caller can observe.

      Set it when the value the device itself reports is worth the bus time,
      such as during bring-up with the shell.
```

## dts/bindings/encoder/cui,amt21.yaml
```yaml
description: |
  Same Sky (CUI Devices) AMT21x absolute encoder bus.

  This node owns a half-duplex RS485 UART and polls every encoder child node in
  turn. It must be a child of the UART node it drives.

  The transport keeps the UART receiver permanently enabled instead of arming it
  per transaction: at 2 Mbps the encoder starts replying about 3 us after the
  command byte, which is far too soon to re-arm a receiver in software.

  Give each bus node a distinct name when a target has more than one. The device
  name comes from the node name, and anything that looks a device up by name,
  such as the shell, cannot tell two identically named buses apart.

    &usart2 {
        current-speed = <2000000>;
        de-enable;
        de-assert-time = <2>;
        de-deassert-time = <2>;

        amt21_bus: amt21 {
            compatible = "cui,amt21";
            #address-cells = <1>;
            #size-cells = <0>;

            encoder0: encoder@54 {
                compatible = "cui,amt21-encoder";
                reg = <0x54>;
                resolution = <14>;
                multiturn;
            };
        };
    };

compatible: "cui,amt21"

include: uart-device.yaml

bus: amt21

properties:
  "#address-cells":
    required: true
    const: 1
  "#size-cells":
    required: true
    const: 0

  poll-interval-us:
    type: int
    default: 1000
    description: |
      Interval between the start of two consecutive scans of every encoder on
      this bus.

      Polling faster than the absolute position update rate of the encoder
      gains nothing: that rate is 100 us for 14-bit devices and 25 us for
      12-bit devices. A scan that overruns this interval causes the next scan
      to be skipped rather than queued, so the bus never accumulates a backlog.

  response-timeout-us:
    type: int
    default: 200
    description: |
      Time to wait for a complete two byte response before the transaction is
      counted as timed out. The encoder turnaround time is 3 us at 2 Mbps and
      up to 110 us at 9600 bps, so this must be raised for the adjustable data
      rate variants running at a low baud rate.

  inter-command-delay-us:
    type: int
    default: 100
    description: |
      Quiet time inserted after a transaction completes, before the next
      command byte is sent. This applies both between the position and turns
      reads of one encoder and between two different encoders.

      Sending commands back to back without this gap is the most common cause
      of dropped responses. The value matches the delay used by the vendor
      sample code.

  rx-quiet-period-us:
    type: int
    default: 20
    description: |
      Minimum time the receive line must have been idle before a command byte
      is sent. A byte arriving inside this window means a previous response was
      late, so the transport flushes and retries instead of transmitting on top
      of it.

  max-retries:
    type: int
    default: 2
    description: |
      Number of times a failed transaction is retried before the reading is
      given up on for the current scan. Each retry observes
      inter-command-delay-us.

  offline-threshold:
    type: int
    default: 3
    description: |
      Number of consecutive failed transactions after which an encoder is
      reported offline. Below this threshold the last good reading is kept and
      reported as stale, so a single dropped response does not disturb a
      control loop.

  tx-echo:
    type: boolean
    description: |
      Set this when the RS485 transceiver has its receiver permanently enabled,
      which makes the transmitted command byte appear back on the receive line.
      The transport then expects the echo before the response and discards it.

      When this property is absent the transport determines the behaviour from
      the first successful transaction.

  de-gpios:
    type: phandle-array
    description: |
      Driver enable output of the RS485 transceiver, for SoCs whose UART cannot
      drive it in hardware.

      Prefer hardware driver enable where available, such as the de-enable
      property of an STM32 UART. Toggling this GPIO from software adds latency
      around the turnaround window and is not usable at 2 Mbps.
```

## dts/bindings/encoder/dji,robomaster-encoder.yaml
```yaml
description: |
  The rotor angle of a DJI RoboMaster C610/C620, exposed as an encoder.

  A RoboMaster ESC reports its rotor angle (0..8191) in every feedback frame.
  This node turns that into an encoder class device, so a control loop that
  takes encoders can close around the motor's own rotor instead of an encoder
  fitted to the output shaft.

    rm_enc1: robomaster-encoder-1 {
        compatible = "dji,robomaster-encoder";
        motor = <&rm_motor1>;
    };

  The counts are rotor counts, 8192 per rotor revolution, before the motor's
  gearbox. The position starts at the rotor angle of the first frame, and
  starts over (with a new position_epoch) whenever the motor has been silent
  for longer than the transport's feedback-timeout-ms, because the rotor can
  have turned any number of times in between.

  The node carries no reg, so give each one a distinct name: the device name
  is the bare node name.

compatible: "dji,robomaster-encoder"

include: base.yaml

properties:
  motor:
    type: phandle
    required: true
    description: |
      The dji,robomaster-motor node whose rotor this encoder reads. Each motor
      can back one encoder.

  invert-direction:
    type: boolean
    description: |
      Report motion with the opposite sign. The single-turn value stays what
      the ESC reported.
```

## dts/bindings/encoder/fibril,stm32-qdec.yaml
```yaml
description: |
  Quadrature encoder decoded by an STM32 general purpose timer.

  This node must be a child of the timer node it drives. The timer node itself
  does not take pinctrl-0; the two input pins belong to this node.

  Do not name the node "qdec". The SoC dtsi already declares a disabled child of
  that name under every st,stm32-timers node for the upstream st,stm32-qdec
  driver, so a node of the same name merges into it and inherits its properties.

  Give each node a distinct name when a target has more than one. These nodes
  carry no reg, so the device name is the bare node name, and two encoders named
  alike produce two devices that nothing can tell apart by name.

    &timers3 {
        status = "okay";
        st,prescaler = <0>;

        qdec3: encoder3 {
            compatible = "fibril,stm32-qdec";
            pinctrl-0 = <&tim3_ch1_pb4 &tim3_ch2_pb5>;
            pinctrl-names = "default";
            counts-per-revolution = <2048>;
            status = "okay";
        };
    };

  The driver sets the timer's auto-reload to the full width of its counter, so
  the counter wraps at a power of two and the accumulated position stays
  continuous across the wrap. This is the difference from the upstream
  st,stm32-qdec binding, which sets auto-reload to a multiple of the counts per
  revolution and does not publish the value, leaving a consumer unable to tell
  where the counter wraps.

  The parent's st,prescaler must be zero. The prescaler divides in encoder mode
  as well, so a non-zero value drops counts.

compatible: "fibril,stm32-qdec"

include: [base.yaml, pinctrl-device.yaml]

properties:
  pinctrl-0:
    required: true

  pinctrl-names:
    required: true

  counts-per-revolution:
    type: int
    required: true
    description: |
      Counts the timer records per revolution of the encoder shaft, after the
      x1, x2 or x4 multiplication that encoder-mode selects.

      The driver does not use this. It is here because converting counts to a
      physical quantity needs it and it is a property of the device rather than
      of the application, unlike the gear ratio and the wheel radius.

  poll-interval-us:
    type: int
    default: 1000
    description: |
      Interval between two reads of the hardware counter.

      The driver samples on its own rather than when a reading is requested,
      because the counter has to be observed at least twice per wrap for the
      accumulated position to stay continuous. At 16 bits the counter wraps
      every 65536 counts, so the interval bounds the speed that can be
      resolved.

      An interval shorter than one kernel tick is rounded up to a tick.

  encoder-mode:
    type: int
    default: 3
    enum:
      - 1       # x2, counting on tim_ti1fp1 edges only
      - 2       # x2, counting on tim_ti2fp2 edges only
      - 3       # x4, counting on both inputs
      - 0x10006 # x1, counting on tim_ti1fp1
      - 0x10007 # x1, counting on tim_ti2fp2
    description: |
      Slave mode selection written to SMCR.SMS, using the values the reference
      manual gives.

      The default is x4, which resolves every edge of both inputs and is what
      the counts-per-revolution of a datasheet usually assumes.

      The x1 modes need SMS bit 3, which not every STM32 has. Selecting one on
      a part without it fails the build rather than silently decoding wrong.

  input-filter-level:
    type: int
    default: 0
    enum: [0, 1, 2, 3, 4, 5, 6, 7, 8, 9, 10, 11, 12, 13, 14, 15]
    description: |
      Digital filter on both inputs, as the sampling rate and the number of
      consecutive equal samples needed to accept a transition. 0 disables it.

      Raise this when a long or unshielded encoder cable produces counts that
      do not correspond to motion. The mapping from this number to a rate and a
      sample count is in the reference manual, under TIMx_CCMR1 ICxF.

  invert-direction:
    type: boolean
    description: |
      Report motion with the opposite sign.

      The sign is flipped in software rather than by inverting an input
      polarity. In x4 mode inverting both inputs does not reverse the direction
      at all, and inverting only one shifts the phase relationship as well.
```

## dts/bindings/fibril_can_node/fibril,fcan-adc-port.yaml
```yaml
# Copyright (c) 2026
# SPDX-License-Identifier: Apache-2.0

description: |
  The inputs MdMotor's calibration watches, exposed on the CAN bus as the
  schema's AdcPort block type: one instance per child, holding that input's
  threshold. This is CanMotorMbed's ADC port list.

  This node is what puts AdcPort on the bus. The build reads it to emit the
  schema's `instances:` entry, and md_motor reads the inputs through it.

  Each child is one port, in bus-instance order, and reads one of two things:

  - `io-channels`: an ADC channel, normalised to 0..1 of its full scale.
  - `motor`: the current a motor-class device reports, divided by 10000, which
    is how CanMotorMbed turned a RoboMaster's torque into a port. A port that
    climbs above its threshold while the motor pushes against a stop is the
    usual way to find an end without a switch.

    fcan_adc_port: fcan-adc-port {
        compatible = "fibril,fcan-adc-port";
        fcan-ns = "adc{i}";

        torque0 {
            motor = <&rm_motor1>;
        };

        ext0 {
            io-channels = <&adc1 8>;
        };
    };

  The port number a motor's `adc/port` names is the child's position here, so
  reordering the children re-points every motor. The order belongs to the
  deployment snippet, not to the board.

  This node carries no reg and there is no reason to have two of them.

compatible: "fibril,fcan-adc-port"

include: base.yaml

properties:
  fcan-ns:
    type: string
    required: true
    description: |
      The instance namespace on the bus, which becomes the ROS name prefix.
      `{i}` expands to the instance index, so `adc{i}` gives adc0..adcN, the
      names can_md_controller used for the thresholds.

child-binding:
  description: |
    One port. Give exactly one of `io-channels` and `motor`; the build fails
    on a child with neither or both.

  properties:
    io-channels:
      type: phandle-array
      description: |
        The ADC channel to sample. The channel needs its own child node under
        the ADC controller (zephyr,gain, zephyr,resolution and so on), which
        the board's devicetree provides for the pins it brings out.

    motor:
      type: phandle
      description: |
        A motor-class device whose reported current is the input. Reads as no
        sample while the motor is offline or its feedback is stale.
```
