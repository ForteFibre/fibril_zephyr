## dts/bindings/fibril_can_node/fibril,fcan-md-motor.yaml
```yaml
# Copyright (c) 2026
# SPDX-License-Identifier: Apache-2.0

description: |
  Motors closed around an encoder on the board, exposed on the CAN bus as the
  schema's MdMotor block type. This is the motor driver CanMotorMbed used to
  be: the board runs the speed and position loops (lib/motor_control), and the
  master sends targets and gains.

  This node is what puts MdMotor on the bus. The build reads it to emit the
  schema's `instances:` entry, so describing the wiring is the whole of adding
  the function to an image.

  Each instance pairs one entry of `motors` with the entry of `encoders` at
  the same position, so the two lists must have the same length. Instance 0
  on the bus is the first pair; reordering the lists renames every motor on
  the ROS side.

    fcan_md_motor: fcan-md-motor {
        compatible = "fibril,fcan-md-motor";
        fcan-ns = "motor{i}";
        motors = <&wheel_left>, <&wheel_right>;
        encoders = <&qdec_left>, <&qdec_right>;
        status = "okay";
    };

  The motors are driven with current commands (MOTOR_OUTPUT_MODE_CURRENT). The
  control core works in duty, which `duty-full-scale` turns into the motor's
  raw current unit; the motor's own limit (such as `max-current` on a
  RoboMaster) still clamps the result.

  This node carries no reg and there is no reason to have two of them. The
  implementation reads the first enabled node only, so a second one is a
  build error rather than a silently ignored list of motors.

compatible: "fibril,fcan-md-motor"

include: base.yaml

properties:
  fcan-ns:
    type: string
    required: true
    description: |
      The instance namespace on the bus, which becomes the ROS name prefix.
      `{i}` expands to the instance index, so `motor{i}` gives
      motor0..motorN.

      The `{i}` may be left out only when CONFIG_FIBRIL_CAN_NODE_MD_MOTOR_MAX
      is 1; the codegen keys that rule on the ceiling, not on how many motors
      are wired.

  motors:
    type: phandles
    required: true
    description: |
      One motor-class device per instance, in bus-instance order. The device
      must accept MOTOR_OUTPUT_MODE_CURRENT.

      The count has to fit CONFIG_FIBRIL_CAN_NODE_MD_MOTOR_MAX. CMake cannot
      read a phandle list, so the ceiling is a Kconfig value; a BUILD_ASSERT
      in the implementation catches an overflow.

  encoders:
    type: phandles
    required: true
    description: |
      One encoder-class device per instance, paired with `motors` by
      position. Positive encoder counts must correspond to positive current
      on the paired motor, or the loops run away; flip the encoder
      (`invert-direction` on a qdec) rather than the motor to fix it.

  duty-full-scale:
    type: int
    default: 10000
    description: |
      The raw current command a duty of 1.0 maps to.

      10000 is what CanMotorMbed sent to a RoboMaster C610/C620 at duty 1.0,
      so the gains tuned on that firmware keep their meaning here. It is
      deliberately not the motor's `max-current`: lowering that limit should
      cap the output, not rescale every gain.
```

## dts/bindings/fibril_can_node/fibril,fcan-odometry.yaml
```yaml
# Copyright (c) 2026
# SPDX-License-Identifier: Apache-2.0

description: |
  The inputs of a dead reckoning, exposed on the CAN bus as the schema's
  Odometry block type: two ground encoders and a gyro. This is what PCMainFW
  sent its host for fibril_localization.

  This node is what puts Odometry on the bus. The build reads it to emit the
  schema's `instances:` entry, which always holds one instance.

    fcan_odometry: fcan-odometry {
        compatible = "fibril,fcan-odometry";
        fcan-ns = "odom";
        encoders = <&enc3 &enc4>;
        imu = <&gyro>;
        status = "okay";
    };

  This node carries no reg and there is no reason to have two of them.

compatible: "fibril,fcan-odometry"

include: base.yaml

properties:
  fcan-ns:
    type: string
    required: true
    description: |
      The instance namespace on the bus, which becomes the ROS name prefix.
      There is one instance, so it needs no `{i}`.

      Required rather than defaulted: a name that reaches the ROS graph
      belongs to the robot, not to the binding.

  encoders:
    type: phandles
    required: true
    description: |
      The two ground encoders, as encoder0 and encoder1 of OdometryEncoder in
      that order. Any encoder class device will do. Their counts are
      published raw; the scale to a distance belongs to the dead reckoning's
      encoder_gain0 and encoder_gain1.

  imu:
    type: phandle
    required: true
    description: |
      The gyro, any IMU class device. Its yaw is published with the device's
      sign.
```

## dts/bindings/fibril_can_node/fibril,fcan-odrive.yaml
```yaml
# Copyright (c) 2026
# SPDX-License-Identifier: Apache-2.0

description: |
  ODrive axes exposed on the CAN bus as the schema's ODriveMotor block type,
  the successor of fibril_ros's fibril_odrive_adapter.

  This node is what puts ODriveMotor on the bus. The build reads it to emit
  the schema's `instances:` entry, so describing the wiring is the whole of
  adding the function to an image.

  One node covers every ODrive the board drives. Each entry of `axes` becomes
  one schema instance, in the order written, so instance 0 on the bus is the
  first phandle here. The order is the contract with the ROS side, as the
  adapter's motor0..motorN were; reordering the list renames every joint.

    fcan_odrive: fcan-odrive {
        compatible = "fibril,fcan-odrive";
        fcan-ns = "motor{i}";
        axes = <&steer0>, <&steer1>, <&steer2>, <&steer3>;
        status = "okay";
    };

  The axes themselves stay where the driver expects them, as `odrive,axis`
  children of an `odrive,bus` node, and may be spread over several buses.
  This node only says which of them the bus should see and in what order.

  This node carries no reg and there is no reason to have two of them. The
  implementation reads the first enabled node only, so a second one is a build
  error rather than a silently ignored list of axes.

compatible: "fibril,fcan-odrive"

include: base.yaml

properties:
  fcan-ns:
    type: string
    required: true
    description: |
      The instance namespace on the bus, which becomes the ROS name prefix.
      `{i}` expands to the instance index, so `motor{i}` gives the adapter's
      motor0..motorN.

      The `{i}` may be left out only when CONFIG_FIBRIL_CAN_NODE_ODRIVE_MAX
      is 1; the codegen keys that rule on the ceiling rather than on how many
      axes are wired.

  axes:
    type: phandles
    required: true
    description: |
      One `odrive,axis` node per ODrive, in bus-instance order.

      The count has to fit CONFIG_FIBRIL_CAN_NODE_ODRIVE_MAX. CMake cannot
      read a phandle list, so the ceiling is a Kconfig value rather than this
      length; a BUILD_ASSERT in the implementation catches an overflow.
```

## dts/bindings/fibril_can_node/fibril,fcan-robstride.yaml
```yaml
# Copyright (c) 2026
# SPDX-License-Identifier: Apache-2.0

description: |
  RobStride actuators exposed on the CAN bus as the schema's RobstrideMotor
  block type.

  This node is what puts RobstrideMotor on the bus. The build reads it to emit
  the schema's `instances:` entry, so describing the wiring is the whole of
  adding the function to an image; there is no second list to keep in step.

  One node covers every actuator the board drives. Each entry of `motors`
  becomes one schema instance, in the order written, so instance 0 on the bus
  is the first phandle here. The order is the contract with the ROS side;
  reordering the list renames every joint.

    fcan_robstride: fcan-robstride {
        compatible = "fibril,fcan-robstride";
        fcan-ns = "joint{i}";
        motors = <&joint_knee>, <&joint_hip>;
        status = "okay";
    };

  The actuators themselves stay where the driver expects them, as
  `robstride,motor` children of a `robstride,bus` node. This node only says
  which of them the bus should see and in what order, so a motor that is
  wired but deliberately not exposed is simply left out of `motors`.

  What the bus can command is decided there too. `max-current-ma` on the motor
  is the full-scale value a `fibril_control_msgs/msg/Target` of type DUTY is
  measured against, so a deployment that leaves it at the model limit gives
  DUTY a much coarser meaning than the ROS 2 original did.

  This node carries no reg and there is no reason to have two of them. The
  implementation reads the first enabled node only, so a second one is a build
  error rather than a silently ignored list of actuators.

compatible: "fibril,fcan-robstride"

include: base.yaml

properties:
  fcan-ns:
    type: string
    required: true
    description: |
      The instance namespace on the bus, which becomes the ROS name prefix.
      `{i}` expands to the instance index, so `joint{i}` gives joint0..jointN.

      It is required unless CONFIG_FIBRIL_CAN_NODE_ROBSTRIDE_MAX is 1 — the
      rule is keyed on that ceiling, not on how many actuators are wired, so
      the default requires it even for a lone motor. The codegen rejects a
      namespace that lacks it, so this is a build error, not a collision
      discovered on the ROS graph.

      Required rather than defaulted: a name that reaches the ROS graph
      belongs to the robot, not to the binding.

  motors:
    type: phandles
    required: true
    description: |
      One `robstride,motor` node per actuator, in bus-instance order.

      The count has to fit CONFIG_FIBRIL_CAN_NODE_ROBSTRIDE_MAX, which is the
      static ceiling the generated code allocates for. CMake cannot read a
      phandle list, so the ceiling is a Kconfig value rather than this length;
      a BUILD_ASSERT in the implementation catches an overflow.
```

## dts/bindings/fibril_can_node/fibril,fcan-solenoid.yaml
```yaml
# Copyright (c) 2026
# SPDX-License-Identifier: Apache-2.0

description: |
  Solenoid valve outputs exposed on the CAN bus as the schema's Solenoid block
  type.

  This node is what puts Solenoid on the bus. The build reads it to emit the
  schema's `instances:` entry, so describing the hardware is the whole of
  adding the function to an image; there is no second list to keep in step.

  One node describes every valve the board drives. Each entry of `gpios` becomes
  one schema instance, in the order written, so instance 0 on the bus is the
  first phandle here. The order is the contract with the ROS side and with the
  wiring diagram; reordering the list renames every valve.

    fcan_solenoid: fcan-solenoid {
        compatible = "fibril,fcan-solenoid";
        fcan-ns = "air{i}";
        gpios = <&gpioa 1 GPIO_ACTIVE_HIGH>,
                <&gpioa 6 GPIO_ACTIVE_HIGH>;
        status = "okay";
    };

  This node carries no reg and there is no reason to have two of them. The
  implementation reads the first enabled node only, so a second one is a
  build error rather than a silently ignored list of valves.

compatible: "fibril,fcan-solenoid"

include: base.yaml

properties:
  fcan-ns:
    type: string
    required: true
    description: |
      The instance namespace on the bus, which becomes the ROS name prefix.
      `{i}` expands to the instance index, so `air{i}` gives air0..airN.

      It is required unless CONFIG_FIBRIL_CAN_NODE_SOLENOID_MAX is 1 — the
      rule is keyed on that ceiling, not on how many valves are wired, so
      the default of 8 requires it even for a lone valve. The codegen
      rejects a namespace that lacks it, so this is a build error, not a
      collision discovered on the ROS graph.

      Required rather than defaulted: a name that reaches the ROS graph
      belongs to the robot, not to the binding.

  gpios:
    type: phandle-array
    required: true
    description: |
      One entry per valve, in bus-instance order. Active level belongs here
      rather than in the driver: a board may switch the load high-side or
      low-side, and only the schematic says which.

      The count has to fit CONFIG_FIBRIL_CAN_NODE_SOLENOID_MAX, which is the
      static ceiling the generated code allocates for. CMake cannot read a
      phandle-array, so the ceiling is a Kconfig value rather than this
      length; a BUILD_ASSERT in the implementation catches an overflow.
```

## dts/bindings/imu/cruizcore,r6093u.yaml
```yaml
# Copyright (c) 2026
# SPDX-License-Identifier: Apache-2.0

description: |
  CruizCore R6093U gyro on a UART.

  The device streams a 26 byte packet at about 100 Hz without being asked, so
  this node only listens, apart from the reset command the driver sends at
  boot to zero the yaw. It must be a child of the UART node it is wired to,
  and that UART runs at the device's fixed 38400 bps.

    &uart5 {
        current-speed = <38400>;
        status = "okay";

        gyro: r6093u {
            compatible = "cruizcore,r6093u";
        };
    };

  Give each node a distinct name when a target has more than one. The node
  carries no reg, so the device name is the bare node name.

compatible: "cruizcore,r6093u"

include: uart-device.yaml

properties:
  stale-timeout-ms:
    type: int
    default: 50
    description: |
      Age of the latest packet beyond which a reading is reported stale. The
      default allows four missed packets at the device's 10 ms rate.

  offline-timeout-ms:
    type: int
    default: 500
    description: |
      Age of the latest packet beyond which the device is reported offline.
      It is also how often the driver re-arms the UART receiver while nothing
      arrives, which is what brings back a receiver stopped by an error that
      went unnoticed. Must not be shorter than stale-timeout-ms.
```

## dts/bindings/mfd/dji,robomaster.yaml
```yaml
compatible: "dji,robomaster"

description: DJI RoboMaster C610/C620 motor driver binding
properties:
  canbus:
    required: true
    type: phandles
    description: "CAN bus controller to which the motor is connected"
  auto-probe:
    required: false
    type: boolean
    description: "In case of multiple CAN buses, automatically detect the correct bus for each motor"

bus: dji,robomaster
```

## dts/bindings/motor/dji,robomaster-motor.yaml
```yaml
description: DJI RoboMaster C610/C620 motor node

compatible: "dji,robomaster-motor"

include: base.yaml

on-bus: dji,robomaster

properties:
  reg:
    required: true
    description: Motor ID on the RoboMaster bus, in the range 1..8.
  model:
    type: string
    required: true
    enum:
      - c610
      - c620
    description: Motor controller model.
  max-current:
    type: int
    description: Maximum absolute current command accepted by this motor node.
  gear-ratio:
    type: int
    description: Optional motor gear ratio metadata for higher-level control.
```

## dts/bindings/motor/dji,robomaster.yaml
```yaml
description: DJI RoboMaster motor transport

compatible: "dji,robomaster"

include: motor-controller.yaml

properties:
  cans:
    type: phandles
    required: true
    description: >
      One or more CAN controller devices used to talk to RoboMaster motors.
      Motor IDs must be unique within this transport.
  feedback-timeout-ms:
    type: int
    default: 100
    description: >
      Feedback is reported stale when no update has been received within this
      timeout.
```

## dts/bindings/motor/dji/dji,robomaster-motor.yaml
```yaml
compatible: "dji,robomaster-motor"

description: "Binding for each DJI RoboMaster motor"
include:
  - motor-controller.yaml
properties:
  motor-id:
    required: true
    type: int
    description: "ID of the motor on the CAN bus"
    enum: [1, 2, 3, 4, 5, 6, 7, 8]

on-bus: dji,robomaster
```
