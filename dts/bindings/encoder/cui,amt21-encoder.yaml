## dts/bindings/motor/motor-controller.yaml
```yaml
description: Common properties for motor controller buses

include: base.yaml

bus: dji,robomaster

properties:
  "#address-cells":
    required: true
    const: 1
  "#size-cells":
    required: true
    const: 0
```

## dts/bindings/motor/odrive,axis.yaml
```yaml
description: |
  ODrive axis.

  One node per axis, which is one ODrive on the Pro, S1 and Micro. The
  properties here are the ones that are fixed once the ODrive is wired into the
  machine.

  Limits and gains are deliberately absent. They live in the ODrive's own
  configuration, written with odrivetool and kept across reboots by
  save_configuration(); writing them from the firmware on every enable would
  make it ambiguous which of the two is in effect. Targets and run-time
  overrides are set through include/drivers/motor/odrive.h.

compatible: "odrive,axis"

include: base.yaml

on-bus: odrive

properties:
  reg:
    required: true
    description: >
      CAN node ID of this axis, in the range 0 to 62. 63 is the unaddressed
      value an unconfigured ODrive starts with and is rejected at init. It must
      be unique on the bus.
  has-motor-thermistor:
    type: boolean
    description: >
      Set when a motor thermistor is wired and configured on this ODrive.
      Without one the ODrive reports a motor temperature of 0, and 0 degrees
      reads as a real measurement rather than as a missing sensor, so the
      driver leaves MOTOR_FEEDBACK_TEMPERATURE out of the snapshot unless this
      is set. The FET temperature is reported through odrive_get_feedback()
      either way.
```

## dts/bindings/motor/odrive,bus.yaml
```yaml
description: |
  ODrive CANSimple bus.

  One node per CAN controller that carries CANSimple traffic. The protocol is
  classic CAN with 11-bit identifiers, so a controller under this node cannot
  also carry CAN FD traffic.

compatible: "odrive,bus"

include: base.yaml

bus: odrive

properties:
  "#address-cells":
    required: true
    const: 1
  "#size-cells":
    required: true
    const: 0
  can:
    type: phandle
    required: true
    description: >
      CAN controller used to talk to the ODrives on this bus. An ODrive is
      addressed by its own node ID and the host carries no identifier of its
      own, so the driver never has to work out which controller an axis is on.
      A board with two controllers gets two bus nodes.
  heartbeat-timeout-ms:
    type: int
    default: 300
    description: >
      An axis is reported offline when no heartbeat has arrived within this
      timeout. The ODrive sends one every heartbeat_msg_rate_ms, which defaults
      to 100, so this has to leave room for several of them.
  estimate-timeout-ms:
    type: int
    default: 100
    description: >
      Position and velocity are reported stale when no Get_Encoder_Estimates
      frame has arrived within this timeout. The ODrive sends one every
      encoder_msg_rate_ms, which defaults to 10.
```

## dts/bindings/motor/robstride,bus.yaml
```yaml
description: |
  RobStride actuator bus.

  One node per set of CAN controllers that carry RobStride traffic. The
  protocol is classic CAN with 29-bit identifiers at 1 Mbit/s, so a controller
  under this node cannot also carry CAN FD traffic.

compatible: "robstride,bus"

include: base.yaml

bus: robstride

properties:
  "#address-cells":
    required: true
    const: 1
  "#size-cells":
    required: true
    const: 0
  cans:
    type: phandles
    required: true
    description: >
      One or more CAN controller devices used to talk to RobStride actuators.
      Motor IDs must be unique across this bus. Until a motor has answered, the
      driver does not know which controller it is on and addresses all of them.
  master-can-id:
    type: int
    default: 253
    description: >
      Host identifier carried in the low 8 bits of every frame. The driver
      filters received frames on it, so it must differ from the reg of every
      motor on this bus. 253 is the value the ROS 2 reference implementation
      defaults to.
  feedback-timeout-ms:
    type: int
    default: 100
    description: >
      Feedback is reported stale when no frame has arrived from a motor within
      this timeout. Feedback arrives as the reply to each command, so this has
      to leave room for several command intervals.
```

## dts/bindings/motor/robstride,motor.yaml
```yaml
description: |
  RobStride actuator.

  The properties here are the ones that are fixed once the actuator is wired
  into the machine. Loop gains and the targets themselves are set at run time
  through include/drivers/motor/robstride.h.

  The direction of rotation and the gear ratio are deliberately absent. Both
  end up as a scale the control layer applies when it turns counts into a
  physical quantity, and splitting that scale between the driver and the
  control layer makes the accumulated position harder to reason about.

compatible: "robstride,motor"

include: base.yaml

on-bus: robstride

properties:
  reg:
    required: true
    description: >
      CAN ID of this actuator, in the range 1..127. It must differ from the
      master-can-id of the bus.
  model:
    type: string
    required: true
    enum:
      - rs00
      - rs05
    description: >
      Actuator model. It fixes the velocity, torque and current ranges used to
      encode commands and decode feedback, so a wrong value silently scales
      every value on this motor.
  max-current-ma:
    type: int
    description: >
      Current limit written to the motor, in mA. Defaults to the model limit.
  max-velocity-mrad-s:
    type: int
    description: >
      Velocity limit written to the motor, in mrad/s. Defaults to the model
      limit.
  max-torque-mnm:
    type: int
    description: >
      Torque limit written to the motor, in mNm. Defaults to the model limit.
```

## dts/bindings/node_id/fibril,id-switch.yaml
```yaml
# Copyright (c) 2026
# SPDX-License-Identifier: Apache-2.0

description: |
  A rotary or DIP switch that sets which unit a board is, read once at boot.

  The switch's bits are listed in `gpios`, least significant first, and read
  as one unsigned number. Give each GPIO the flags that make a set bit read
  as active, which on a switch that pulls to ground is
  (GPIO_PULL_UP | GPIO_ACTIVE_LOW).

    rotary_id: rotary-id {
        compatible = "fibril,id-switch";
        gpios = <&gpioc 0 (GPIO_PULL_UP | GPIO_ACTIVE_LOW)>,
                <&gpioc 1 (GPIO_PULL_UP | GPIO_ACTIVE_LOW)>,
                <&gpioe 3 (GPIO_PULL_UP | GPIO_ACTIVE_LOW)>,
                <&gpioe 2 (GPIO_PULL_UP | GPIO_ACTIVE_LOW)>;
    };

  A board points `chosen { fibril,node-id = ...; }` at the switch when the
  switch is what gives the fibril_can node its id; lib/node_id reads it.

compatible: "fibril,id-switch"

include: base.yaml

properties:
  gpios:
    type: phandle-array
    required: true
    description: |
      One GPIO per bit, least significant bit first. At most 7, since a
      fibril_can node id is 7 bits wide.
```

## dts/bindings/sensor/ams,as5047p.yaml
```yaml
# Copyright (c) 2026 Forte Fibre
# SPDX-License-Identifier: Apache-2.0

description: ams AS5047P SPI angular position sensor

compatible: "ams,as5047p"

include: ["spi-device.yaml", "sensor-device.yaml"]
```

## lib/fcan_transport/Kconfig
```kconfig
# Copyright (c) 2026
# SPDX-License-Identifier: Apache-2.0

config FCAN_TRANSPORT
	bool "fibril_can node transport backends"
	depends on FIBRIL_CAN
	help
	  Hide from the application where a node's HAL comes from and which
	  thread drives fcan_poll. The devicetree picks the backend.

if FCAN_TRANSPORT

config FCAN_TRANSPORT_HUB
	bool
	default y
	depends on CAN_FCAN_HUB
	help
	  The node is the self port of a CAN hub. Selected by a
	  "fibril,can-hub" node in the devicetree, which is what turns
	  CAN_FCAN_HUB on in the first place.

config FCAN_TRANSPORT_DIRECT
	bool
	default y
	depends on !CAN_FCAN_HUB
	help
	  The node sits directly on the CAN controller named by the
	  zephyr,canbus chosen node.

config FCAN_TRANSPORT_GS_USB
	bool "Face the external port at a USB host through CANnectivity gs_usb"
	default y
	depends on USBD_GS_USB
	help
	  A PC on SocketCAN then sees this node's bus as a single canX
	  interface. USBD_GS_USB itself defaults on from a "gs_usb" node in
	  the devicetree, so describing the hardware is enough; the
	  application still has to turn USB_DEVICE_STACK_NEXT on.

	  Only a backend with an external port can use this. A node wired
	  straight to a CAN controller has none.

module = FCAN_TRANSPORT
module-str = fcan_transport
source "subsys/logging/Kconfig.template.log_config"

endif # FCAN_TRANSPORT
```

## lib/fibril_can_node/Kconfig
```kconfig
# Copyright (c) 2026
# SPDX-License-Identifier: Apache-2.0

menuconfig FIBRIL_CAN_NODE
	bool "fibril_can node functions"
	depends on FIBRIL_CAN
	help
	  Implementations of the schema's block types, layered on this
	  repository's drivers.

	  Every source under this option includes the codegen's schema_gen.h,
	  which only exists in an application that calls fcan_invoke_codegen().
	  Applications that are not fibril_can slaves leave this off.

if FIBRIL_CAN_NODE

config FIBRIL_NODE_SCHEMA
	string "Node schema header, relative to this repository's root"
	help
	  The YAML naming this node on the bus and declaring its resource
	  limits. It carries no instances: those come from the devicetree,
	  one fragment per enabled function.

	  Snippets set this. The application resolves it against
	  ZEPHYR_FIBRIL_ZEPHYR_MODULE_DIR and hands it to the codegen
	  alongside the generated fragments.

config FIBRIL_NODE_ID
	int "fibril_can node id"
	range 0 126
	default 16
	help
	  0x7F is the broadcast address and cannot be used.

	  Interim: on a real board the id comes from a DIP switch or a config
	  ROM, so that two identical boards can run one image. RC26 MainAir V01
	  has no such input in its devicetree yet, so the id is fixed at build
	  time here. Replace this with the runtime read once lib/node_id/
	  exists.

rsource "solenoid/Kconfig"

module = FIBRIL_CAN_NODE
module-str = fibril_can_node
source "subsys/logging/Kconfig.template.log_config"

endif # FIBRIL_CAN_NODE
```
