/*
 * Copyright (c) 2026
 * SPDX-License-Identifier: Apache-2.0
 *
 * The RC26 MainAir V01's ODrive bus on external CAN1 (board silkscreen),
 * which is FDCAN2, as odrive0, with no axis on it.
 *
 * CAN1 is also where dts/fibril/rc26_mainair_v01/robstride.dtsi puts the
 * RobStride bus, and the board has no third controller, so an image carries
 * one or the other; the FDCAN2 claim below turns a deployment asking for both
 * into a build error. The bus stays apart from the fibril_can one for the
 * same reason as the RobStride bus: CANSimple is classic CAN.
 *
 * The axes are not defined here. A deployment adds exactly the ODrives it
 * wires, by their node_id:
 *
 *     &odrive0 {
 *         steer0: axis@0 {
 *             compatible = "odrive,axis";
 *             reg = <0>;
 *         };
 *     };
 */

#ifndef FIBRIL_RC26_MAINAIR_V01_ODRIVE_DTSI
#define FIBRIL_RC26_MAINAIR_V01_ODRIVE_DTSI

#include <fibril/can-bitrate.h>

#ifdef FIBRIL_CLAIM_FDCAN2
#error "FDCAN2 claimed twice; the ODrive bus is one claimant"
#endif
#define FIBRIL_CLAIM_FDCAN2 1

/*
 * No data phase, as for RobStride. 1 Mbps is the actuator rate this
 * repository uses everywhere; an ODrive ships at 250 kbps, so each one needs
 * can.config.baud_rate set to match.
 */
&fdcan2 {
    status = "okay";
    bitrate = <FIBRIL_ACTUATOR_CAN_BITRATE>;
};

/ {
    odrive0: odrive-bus {
        compatible = "odrive,bus";
        #address-cells = <1>;
        #size-cells = <0>;
        can = <&fdcan2>;
    };
};

#endif /* FIBRIL_RC26_MAINAIR_V01_ODRIVE_DTSI */
