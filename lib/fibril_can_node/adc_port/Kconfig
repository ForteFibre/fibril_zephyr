## lib/fibril_can_node/adc_port/Kconfig
```kconfig
# Copyright (c) 2026
# SPDX-License-Identifier: Apache-2.0

config FIBRIL_CAN_NODE_ADC_PORT
	bool
	default y
	depends on DT_HAS_FIBRIL_FCAN_ADC_PORT_ENABLED
	imply ADC
	imply MOTOR
	help
	  Compiled whenever the devicetree lists calibration inputs under a
	  fibril,fcan-adc-port node, which is also what puts AdcPort instances
	  into the schema. MdMotor's calibration reads its inputs through this;
	  without it, sensor_state answers that the node has no ports.

	  ADC and MOTOR are implied rather than selected: a port list made of
	  only one kind needs only that subsystem, and the build of the other
	  kind fails loudly if it is turned off.

config FIBRIL_CAN_NODE_ADC_PORT_MAX
	int "AdcPort instances to allocate for"
	default 16
	range 1 32
	depends on FIBRIL_CAN_NODE_ADC_PORT
	help
	  The schema's max_count for AdcPort: how many instances the generated
	  code reserves state for. It is a ceiling, not a count, and never
	  reaches the schema blob.

	  16 covers CanMotorMbed's miniv4 layout of 13 ports. Lowering it below
	  the devicetree's child count fails the BUILD_ASSERT in adc_port.cpp.
```

## lib/fibril_can_node/can_diag/Kconfig
```kconfig
# Copyright (c) 2026
# SPDX-License-Identifier: Apache-2.0

config FIBRIL_CAN_NODE_CAN_DIAG
	bool "Report this board's CAN health on the bus"
	default y
	depends on FCAN_TRANSPORT
	imply STATS
	imply CAN_STATS
	help
	  Publish the CanPortDiag and CanHubDiag block types (fibril_can's
	  zephyr/schema/can_diag.yaml): each CAN controller's state, error
	  counters, bus-off count and CAN_STATS, and a hub's forwarding
	  counters. The bridge turns them into /<node>/can{i}/diag and
	  /<node>/can_hub/diag.

	  Unlike the other functions this one is not described in the
	  devicetree. The transport decides the instances: one CanPortDiag for
	  the zephyr,canbus controller, or one per hub peer plus a CanHubDiag.
	  On by default so every board reports; turning it off removes the
	  instances from the schema.

	  STATS and CAN_STATS are implied rather than selected, so a board
	  short of RAM can drop the error counters (stats_valid then reads
	  false) and keep the rest.
```

## lib/fibril_can_node/md_motor/Kconfig
```kconfig
# Copyright (c) 2026
# SPDX-License-Identifier: Apache-2.0

config FIBRIL_CAN_NODE_MD_MOTOR
	bool
	default y
	depends on DT_HAS_FIBRIL_FCAN_MD_MOTOR_ENABLED
	select MOTOR
	select ENCODER
	select MOTOR_CONTROL
	help
	  Compiled whenever the devicetree pairs motors with encoders under a
	  fibril,fcan-md-motor node, which is also what puts MdMotor instances
	  into the schema.

	  The leaf drivers are not selected here: they are on by default once
	  their own devicetree nodes exist, and this function works with any
	  motor and encoder class device.

config FIBRIL_CAN_NODE_MD_MOTOR_MAX
	int "MdMotor instances to allocate for"
	default 8
	range 1 32
	depends on FIBRIL_CAN_NODE_MD_MOTOR
	help
	  The schema's max_count for MdMotor: how many instances the generated
	  code reserves state for. It is a ceiling, not a count, and never
	  reaches the schema blob.

	  8 covers every RoboMaster a two-bus board can address, which is the
	  most CanMotorMbed ever drove from one board. Lowering it below the
	  devicetree's length fails the BUILD_ASSERT in md_motor.cpp.
```

## lib/fibril_can_node/odometry/Kconfig
```kconfig
# Copyright (c) 2026
# SPDX-License-Identifier: Apache-2.0

config FIBRIL_CAN_NODE_ODOMETRY
	bool
	default y
	depends on DT_HAS_FIBRIL_FCAN_ODOMETRY_ENABLED
	select ENCODER
	select IMU
	help
	  Compiled whenever the devicetree names the ground encoders and the
	  gyro under a fibril,fcan-odometry node, which is also what puts the
	  Odometry instance into the schema.

	  The leaf drivers are not selected here: they are on by default once
	  their own devicetree nodes exist, and this function works with any
	  encoder and IMU class device.
```

## lib/fibril_can_node/odrive/Kconfig
```kconfig
# Copyright (c) 2026
# SPDX-License-Identifier: Apache-2.0

config FIBRIL_CAN_NODE_ODRIVE
	bool
	default y
	depends on DT_HAS_FIBRIL_FCAN_ODRIVE_ENABLED
	select MOTOR
	select MOTOR_ODRIVE
	select ODRIVE_SEQUENCER
	help
	  Compiled whenever the devicetree describes the axes, which is also
	  what puts ODriveMotor instances into the schema. Describing the
	  wiring is the whole of adding this function to an image.

config FIBRIL_CAN_NODE_ODRIVE_MAX
	int "ODriveMotor instances to allocate for"
	default 8
	range 1 32
	depends on FIBRIL_CAN_NODE_ODRIVE
	help
	  The schema's max_count for ODriveMotor: how many instances the
	  generated code reserves state for. It is a ceiling, not a count; the
	  bus and the ROS graph see only the axes the devicetree names.

	  The driver has a ceiling of its own, MOTOR_ODRIVE_MAX_AXES, which
	  counts the axes on each odrive,bus node. The axes this function names
	  may sit on more than one bus, so neither ceiling derives from the
	  other. Overshooting the driver's makes its registration fail at init,
	  which this function reports as a failed device_is_ready().
```

## lib/fibril_can_node/robstride/Kconfig
```kconfig
# Copyright (c) 2026
# SPDX-License-Identifier: Apache-2.0

config FIBRIL_CAN_NODE_ROBSTRIDE
	bool
	default y
	depends on DT_HAS_FIBRIL_FCAN_ROBSTRIDE_ENABLED
	select MOTOR
	select MOTOR_ROBSTRIDE
	help
	  Compiled whenever the devicetree describes the actuators, which is
	  also what puts RobstrideMotor instances into the schema. Describing
	  the wiring is the whole of adding this function to an image.

	  The driver is selected rather than depended on, because the motor
	  class is off unless something asks for it, and the `motors` phandles
	  have nothing to resolve to without it. A node that names actuators no
	  robstride,bus owns trips the unmet dependency here rather than
	  failing later with an undefined device.

config FIBRIL_CAN_NODE_ROBSTRIDE_MAX
	int "RobstrideMotor instances to allocate for"
	default 8
	range 1 32
	depends on FIBRIL_CAN_NODE_ROBSTRIDE
	help
	  The schema's max_count for RobstrideMotor: how many instances the
	  generated code reserves state for. It is a ceiling, not a count. It
	  never reaches the schema blob, so the bus and the ROS graph see only
	  the actuators the devicetree actually names.

	  8 matches MOTOR_ROBSTRIDE_MAX_MOTORS, the driver's own table size, so
	  a board that fits under one does not trip over the other. Lowering it
	  below the devicetree's length fails the BUILD_ASSERT in robstride.c.
```

## lib/fibril_can_node/solenoid/Kconfig
```kconfig
# Copyright (c) 2026
# SPDX-License-Identifier: Apache-2.0

config FIBRIL_CAN_NODE_SOLENOID
	bool
	default y
	depends on DT_HAS_FIBRIL_FCAN_SOLENOID_ENABLED
	select GPIO
	help
	  Compiled whenever the devicetree describes the valves, which is also
	  what puts Solenoid instances into the schema. Describing the hardware
	  is the whole of adding this function to an image.

config FIBRIL_CAN_NODE_SOLENOID_MAX
	int "Solenoid instances to allocate for"
	default 8
	range 1 32
	depends on FIBRIL_CAN_NODE_SOLENOID
	help
	  The schema's max_count for Solenoid: how many instances the generated
	  code reserves state for. It is a ceiling, not a count. It never
	  reaches the schema blob, so the bus and the ROS graph see only the
	  valves the devicetree actually wires; overshooting costs one byte of
	  .bss per unused instance.

	  Raise it only for a board with more valves than this. Lowering it
	  below the devicetree's length fails the BUILD_ASSERT in solenoid.c.
```

## lib/motor_control/Kconfig
```kconfig
# Copyright (c) 2026
# SPDX-License-Identifier: Apache-2.0

config MOTOR_CONTROL
	bool "Per-motor control core ported from CanMotorMbed"
	depends on CPP && STD_CPP17
	select FIBRIL_COMMON
	help
	  DUTY, SPEED, POSITION and cascaded SPEED_POSITION control with the
	  CanMotorMbed feed-forward and friction terms, a duty slew limit and
	  the encoder stall breaker. The caller samples the encoder and drives
	  the motor; the core only turns one into the other, once per 1 ms
	  tick.
```

## lib/node_id/Kconfig
```kconfig
# Copyright (c) 2026
# SPDX-License-Identifier: Apache-2.0

DT_CHOSEN_FIBRIL_NODE_ID := fibril,node-id

config FIBRIL_NODE_ID_SWITCH
	bool "Read the node id from the board's switch"
	default y
	depends on FIBRIL_CAN_NODE
	depends on $(dt_chosen_enabled,$(DT_CHOSEN_FIBRIL_NODE_ID))
	select GPIO
	help
	  Read the fibril_can node id at boot from the switch the board's
	  `fibril,node-id` chosen node points at, instead of building it into
	  the image. Identical boards then run one image and differ only in
	  where their switch is set (ADR 0003).

	  The switch's value is the node id as it stands, as CanMotorMbed's
	  fibril_can build used it.
```

## lib/odrive_sequencer/Kconfig
```kconfig
# Copyright (c) 2026
# SPDX-License-Identifier: Apache-2.0

config ODRIVE_SEQUENCER
	bool "ODrive axis bring-up and recovery ported from fibril_odrive_adapter"
	depends on CPP && STD_CPP17
	help
	  Calibrates an ODrive axis, arms it when a command arrives, switches
	  control modes through idle and clears errors until the axis can be
	  armed again. The caller reads the ODrive driver's snapshot once per
	  tick and carries out what the sequencer asks of the axis.
```

## subsys/motor_control/Kconfig
```kconfig
menuconfig FIBRIL_MOTOR_CONTROL
	bool "Fibril motor control subsystem"
	depends on CPP
	depends on MOTOR
	default y
	help
	  Enable the reusable C++ motor-control service used by RoboMaster Mini V1.
```

## tests/drivers/encoder/amt21/testcase.yaml
```yaml
common:
  tags:
    - drivers
    - encoder
    - uart
  platform_allow:
    - native_sim
    - native_sim/native/64
  integration_platforms:
    - native_sim
    - native_sim/native/64

tests:
  drivers.encoder.amt21:
    # Aggregate error count only, no per-cause statistics.
    extra_configs:
      - CONFIG_ENCODER_AMT21_STATS=n

  drivers.encoder.amt21.stats:
    extra_configs:
      - CONFIG_ENCODER_AMT21_STATS=y
      - CONFIG_ENCODER_AMT21_ERROR_LOG_SIZE=8

  drivers.encoder.amt21.shell:
    extra_configs:
      - CONFIG_ENCODER_AMT21_STATS=y
      - CONFIG_ENCODER_AMT21_ERROR_LOG_SIZE=8
      - CONFIG_SHELL=y
      - CONFIG_SHELL_BACKEND_DUMMY=y
      - CONFIG_SHELL_BACKEND_SERIAL=n
      - CONFIG_ENCODER_AMT21_SHELL=y
```

## tests/drivers/encoder/robomaster/testcase.yaml
```yaml
tests:
  drivers.encoder.robomaster:
    tags:
      - drivers
      - encoder
      - motor
      - can
    integration_platforms:
      - native_sim
      - native_sim/native/64
```

## tests/drivers/imu/r6093u/testcase.yaml
```yaml
common:
  tags:
    - drivers
    - imu
    - uart
  platform_allow:
    - native_sim
    - native_sim/native/64
  integration_platforms:
    - native_sim
    - native_sim/native/64

tests:
  drivers.imu.r6093u: {}
```

## tests/drivers/motor/robomaster/testcase.yaml
```yaml
tests:
  drivers.motor.robomaster:
    tags:
      - drivers
      - motor
      - can
    integration_platforms:
      - native_sim
      - native_sim/native/64
```

## tests/drivers/motor/robomaster_start_retry/testcase.yaml
```yaml
tests:
  drivers.motor.robomaster.start_retry:
    tags:
      - drivers
      - motor
      - can
    integration_platforms:
      - native_sim
      - native_sim/native/64
```

## tests/drivers/motor/robstride/testcase.yaml
```yaml
tests:
  drivers.motor.robstride:
    tags:
      - drivers
      - motor
      - can
    integration_platforms:
      - native_sim
      - native_sim/native/64
  drivers.motor.robstride.no_verify:
    tags:
      - drivers
      - motor
      - can
    extra_configs:
      - CONFIG_MOTOR_ROBSTRIDE_VERIFY=n
    integration_platforms:
      - native_sim
      - native_sim/native/64
```

## tests/drivers/sensor/as5047p/testcase.yaml
```yaml
tests:
  drivers.sensor.as5047p:
    tags:
      - drivers
      - sensor
      - spi
    integration_platforms:
      - native_sim
      - native_sim/native/64
```

## tests/lib/motor_control/testcase.yaml
```yaml
common:
  tags:
    - lib
    - motor_control
  platform_allow:
    - native_sim
    - native_sim/native/64
  integration_platforms:
    - native_sim
    - native_sim/native/64

tests:
  lib.motor_control: {}
```

## tests/lib/odrive_sequencer/testcase.yaml
```yaml
common:
  tags:
    - lib
    - odrive
  platform_allow:
    - native_sim
    - native_sim/native/64
  integration_platforms:
    - native_sim
    - native_sim/native/64

tests:
  lib.odrive_sequencer: {}
```
