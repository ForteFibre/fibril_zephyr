/*
 * Copyright (c) 2026
 * SPDX-License-Identifier: Apache-2.0
 *
 * The board's five analog inputs as AdcPort 0..4.
 */

#include <fibril/robomaster_miniv4/adc.dtsi>

/ {
    fcan_adc_port: fcan-adc-port {
        compatible = "fibril,fcan-adc-port";
        fcan-ns = "adc{i}";
        status = "okay";

#include <fibril/robomaster_miniv4/adc-ports-ext5.dtsi>
    };
};
