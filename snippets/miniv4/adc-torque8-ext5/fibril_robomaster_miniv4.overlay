/*
 * Copyright (c) 2026
 * SPDX-License-Identifier: Apache-2.0
 *
 * CanMotorMbed's 13 miniv4 ports.
 */

#include <fibril/robomaster_miniv4/robomaster.dtsi>
#include <fibril/robomaster_miniv4/adc.dtsi>

/ {
    fcan_adc_port: fcan-adc-port {
        compatible = "fibril,fcan-adc-port";

        /* adc0..adc12, the names can_md_controller gave the thresholds. */
        fcan-ns = "adc{i}";
        status = "okay";

        /* Ports 0..7. */
#include <fibril/robomaster_miniv4/adc-ports-torque8.dtsi>

        /* Ports 8..12. */
#include <fibril/robomaster_miniv4/adc-ports-ext5.dtsi>
    };
};
