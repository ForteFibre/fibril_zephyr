/*
 * Copyright (c) 2026
 * SPDX-License-Identifier: Apache-2.0
 *
 * Four RoboMaster motors, motor N closed around the board's encoder input
 * ENCN: CanMotorMbed's robomaster_miniv4 build without ROBOMASTER_ENCODER.
 * Closing around the RoboMaster's own rotor instead is miniv4-md-rotor8.
 *
 * The hardware comes from dts/fibril/robomaster_miniv4/; only the pairing is
 * said here.
 */

#include <fibril/robomaster_miniv4/robomaster.dtsi>
#include <fibril/robomaster_miniv4/qdec.dtsi>

/* One node schema per image; see doc/apps.md. */
#ifdef FIBRIL_CLAIM_NODE_ROLE
#error "NODE_ROLE claimed twice; miniv4-md-qdec4 is one claimant"
#endif
#define FIBRIL_CLAIM_NODE_ROLE 1

#ifdef FIBRIL_CLAIM_FCAN_MD_MOTOR
#error "FCAN_MD_MOTOR claimed twice; miniv4-md-qdec4 is one claimant"
#endif
#define FIBRIL_CLAIM_FCAN_MD_MOTOR 1

/ {
    fcan_md_motor: fcan-md-motor {
        compatible = "fibril,fcan-md-motor";

        /* Becomes motor0..motorN on the ROS side, the names
         * can_md_controller used. */
        fcan-ns = "motor{i}";

        motors = <&rm_motor1>, <&rm_motor2>, <&rm_motor3>, <&rm_motor4>;
        encoders = <&enc0>, <&enc1>, <&enc2>, <&enc3>;
        status = "okay";
    };
};
