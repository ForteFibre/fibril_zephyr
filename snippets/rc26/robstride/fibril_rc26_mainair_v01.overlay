/*
 * Copyright (c) 2026
 * SPDX-License-Identifier: Apache-2.0
 *
 * What RC26's actuator node drives. The transport snippet decides how it
 * reaches the fibril_can bus, so nothing here mentions that controller.
 *
 * The bus comes from dts/fibril/rc26_mainair_v01/; the motors and their
 * order are said here.
 */

#include <fibril/rc26_mainair_v01/robstride.dtsi>

/* One node schema per image; see doc/apps.md. */
#ifdef FIBRIL_CLAIM_NODE_ROLE
#error "NODE_ROLE claimed twice; rc26-robstride is one claimant"
#endif
#define FIBRIL_CLAIM_NODE_ROLE 1

#ifdef FIBRIL_CLAIM_FCAN_ROBSTRIDE
#error "FCAN_ROBSTRIDE claimed twice; rc26-robstride is one claimant"
#endif
#define FIBRIL_CLAIM_FCAN_ROBSTRIDE 1

/ {
    fcan_robstride: fcan-robstride {
        compatible = "fibril,fcan-robstride";

        /* Becomes motor0..motorN on the ROS side. */
        fcan-ns = "motor{i}";

        motors = <&joint0>;
        status = "okay";
    };
};

/* One actuator, at the CAN id a RobStride ships with. */
&robstride0 {
    joint0: motor@1 {
        compatible = "robstride,motor";
        reg = <0x01>;
        model = "rs05";

        /* The full-scale value a DUTY target is measured against, and the
         * limit the motor enforces on itself. 2.4 A is the RS05 rated
         * current rather than its 11 A peak, which is both the ROS 2
         * host's default and the value a joint can hold indefinitely. */
        max-current-ma = <2400>;
        status = "okay";
    };
};
